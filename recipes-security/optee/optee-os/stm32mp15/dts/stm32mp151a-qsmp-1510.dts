// SPDX-License-Identifier: (GPL-2.0+ OR BSD-3-Clause)
/*
 * Copyright (C) Lothar Waßmann <LW@KARO-electronics.de>
 */

/dts-v1/;

#include "stm32mp151.dtsi"
#include "stm32mp151-qsmp.dtsi"

/ {
	model = "Ka-Ro electronics GmbH QSMP-1510 solder-in module";
	compatible = "karo,stm32mp151a-qsmp-1510", "st,stm32mp151";

	memory@c0000000 {
		device_type = "memory";
		reg = <0xc0000000 0x10000000>;
	};
};
