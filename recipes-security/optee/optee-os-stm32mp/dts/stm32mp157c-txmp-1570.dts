// SPDX-License-Identifier: (GPL-2.0-or-later OR BSD-3-Clause)
/*
 * Copyright (C) Lothar Waßmann <LW@KARO-electronics.de>
 */

/dts-v1/;

#include "stm32mp157.dtsi"
#include "stm32mp15-txmp.dtsi"

/ {
	model = "Ka-Ro electronics GmbH TXMP-1570 module";
	compatible = "karo,stm32mp157c-txmp-1570", "st,stm32mp157";

	memory@c0000000 {
		device_type = "memory";
		reg = <0xc0000000 0x20000000>;
	};
};
