// SPDX-License-Identifier: (GPL-2.0-only OR BSD-3-Clause)
/*
 * Copyright (C) 2024, STMicroelectronics - All Rights Reserved
 * Copyright (C) 2024 Markus Bauer <MB@KARO-electronics.de>
 */

#define DDR_SIZE        0x10000000 /* 256MB */
#include "stm32mp13-fw-config.dtsi"
#include "stm32mp13-fw-config-mem-encrypt.dtsi"
