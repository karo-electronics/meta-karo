// SPDX-License-Identifier: (GPL-2.0-or-later OR BSD-3-Clause)
/*
 * Copyright (C) STMicroelectronics 2019 - All Rights Reserved
 * Author: STM32CubeMX code generation for STMicroelectronics.
 */

/dts-v1/;

#include "stm32mp157c-txmp.h"
#include "stm32mp15-txmp.dtsi"

/ {
	model = "Ka-Ro electronics GmbH TXMP-1571 module";
	compatible = "karo,stm32mp157c-txmp-1571", "st,stm32mp157";
};
