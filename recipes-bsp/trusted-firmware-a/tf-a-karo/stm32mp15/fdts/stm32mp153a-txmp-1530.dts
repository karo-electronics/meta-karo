// SPDX-License-Identifier: (GPL-2.0+ OR BSD-3-Clause)
/*
 * Copyright (C) STMicroelectronics 2019 - All Rights Reserved
 * Author: STM32CubeMX code generation for STMicroelectronics.
 */

/dts-v1/;

#include "stm32mp153a-txmp.h"
#include "stm32mp15-txmp.dtsi"

/ {
	model = "Ka-Ro electronics GmbH TXMP-1530 module";
	compatible = "karo,stm32mp153a-txmp-1530", "st,stm32mp153";
};
