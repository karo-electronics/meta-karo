// SPDX-License-Identifier: (GPL-2.0-only OR MIT)
/*
 * Copyright (C) 2022 Markus Bauer <mb@karo-electronics.com>
 */

/dts-v1/;

#include "r9a07g044l2-txrz.dtsi"

/ {
	model = "Ka-Ro rzg2l based TXRZ-G2L1";

	memory@48000000 {
		device_type = "memory";
		/* first 128MB is reserved for secure area. */
		reg = <0 0x48000000 0 0x18000000>;
	};
};
