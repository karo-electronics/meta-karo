// SPDX-License-Identifier: (GPL-2.0-or-later OR BSD-3-Clause)
/*
 * Copyright 2023 (C) Lothar Waßmann <LW@KARO-electronics.de>
 */

#include "stm32mp157c-qsmp-1570.dts"

/ {
	model = "Ka-Ro electronics GmbH QSMP-1570 solder-in module on QSBASE1 baseboard";
};

&ethernet0 {
	status = "okay";
};
