// SPDX-License-Identifier: (GPL-2.0-only OR MIT)
/*
 * Device Tree Source for the Ka-Ro G2L based TXRZ CoM
 *
 * Copyright (C) 2023 Markus Bauer <MB@Karo-electronics.de>
 */

#include "r9a07g044l-u-boot.dtsi"
