// SPDX-License-Identifier: (GPL-2.0-or-later OR BSD-3-Clause)
/*
 * Copyright 2020 (C) Lothar Waßmann <LW@KARO-electronics.de>
 */

/dts-v1/;

#include "stm32mp153a-qsmp.h"
#include "stm32mp153-karo.dtsi"
#include "stm32mp153-qsmp.dtsi"
#include "stm32mp153a-karo-scmi.dtsi"

/ {
	model = "Ka-Ro electronics GmbH QSMP-1530 solder-in module";
	compatible = "karo,stm32mp153a-qsmp-1530", "st,stm32mp153";
};
