// SPDX-License-Identifier: (GPL-2.0-or-later OR BSD-3-Clause)
/*
 * Copyright 2022 (C) Markus Bauer <MB@KARO-electronics.de>
 */

#include "stm32mp153a-qsmp-1530.dts"
#include "stm32mp15-qsbase4.dtsi"

/ {
	model = "Ka-Ro electronics GmbH QSMP-1530 solder-in module on QSBASE4 baseboard";
};
