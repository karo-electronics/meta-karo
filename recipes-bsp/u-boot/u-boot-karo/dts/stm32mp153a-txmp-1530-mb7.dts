// SPDX-License-Identifier: (GPL-2.0-or-later OR BSD-3-Clause)
/*
 * Copyright (C) Lothar Waßmann <LW@KARO-electronics.de>
 */

/dts-v1/;

#include "stm32mp153a-txmp-1530.dts"

/ {
	model = "Ka-Ro electronics GmbH TXMP-1530 module on MB7 baseboard";
};
