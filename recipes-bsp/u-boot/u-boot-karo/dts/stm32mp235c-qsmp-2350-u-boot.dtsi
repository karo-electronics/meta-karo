// SPDX-License-Identifier: (GPL-2.0-or-later OR BSD-2-Clause)
/*
 * Copyright (C) 2024, STMicroelectronics - All Rights Reserved
 * Author: STM32CubeMX code generation for STMicroelectronics.
 */

/* For more information on Device Tree configuration, please refer to
 * https://wiki.st.com/stm32mpu/wiki/Category:Device_tree_configuration
 */

#include "stm32mp23-u-boot.dtsi"

&arm_wdt {
	u-boot,noautostart;
};

&usart2 {
	u-boot,dm-pre-reloc;
};

&uart4 {
	u-boot,dm-pre-reloc;
};

&sdmmc2 {
	u-boot,dm-pre-reloc;
};
