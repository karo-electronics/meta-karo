// SPDX-License-Identifier: (GPL-2.0-only or MIT)
/*
 * Device Tree Source for the Ka-Ro G2L based TXRZ CoM
 *
 * Copyright (C) 2022 Markus Bauer <MB@KARO-electronics.de>
 */

/dts-v1/;

#include "r9a07g044l2-txrz-g2l2.dts"

/ {
	model = "Ka-Ro rzg2l based TXRZ-G2L2 on LVDS-MB baseboard";
};
