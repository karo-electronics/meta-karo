// SPDX-License-Identifier: (GPL-2.0-or-later OR BSD-3-Clause)
/*
 * Copyright 2023 (C) Markus Bauer <MB@KARO-electronics.de>
 */

#include "stm32mp157c-qsmp-1570.dts"
#include "stm32mp15-qsbase4.dtsi"

/ {
	model = "Ka-Ro electronics GmbH QSMP-1570 solder-in module on QSGLYN1 baseboard";
};
