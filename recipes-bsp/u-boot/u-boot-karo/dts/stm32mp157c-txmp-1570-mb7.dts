// SPDX-License-Identifier: (GPL-2.0-or-later OR BSD-3-Clause)
/*
 * Copyright (C) Lothar Waßmann <LW@KARO-electronics.de>
 */

#include "stm32mp157c-txmp-1570.dts"

/ {
	model = "Ka-Ro electronics GmbH TXMP-1570 module on MB7 baseboard";
};
