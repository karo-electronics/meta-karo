// SPDX-License-Identifier: (GPL-2.0-only OR BSD-3-Clause)
/*
 * Copyright (C) 2023 Markus Bauer <mb@karo-electronics.com>
 */

/dts-v1/;

#include "r9a07g044l2-qsrz-g2l0.dts"
#include "r9a07g044l2-qsrz-qsbase1.dtsi"

/ {
	model = "Ka-Ro rzg2l based QSRZ-G2L0 on QSBASE1 baseboard";
};
