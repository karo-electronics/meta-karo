// SPDX-License-Identifier: (GPL-2.0+ OR BSD-3-Clause)
/*
 * Copyright (C) Lothar Waßmann <LW@KARO-electronics.de>
 */

#include "stm32mp157-txmp-1571.dts"

/ {
	model = "Ka-Ro electronics GmbH TXMP-1571 module on MB7 baseboard";
};
