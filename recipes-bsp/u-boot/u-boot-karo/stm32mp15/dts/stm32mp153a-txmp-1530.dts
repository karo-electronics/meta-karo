// SPDX-License-Identifier: (GPL-2.0+ OR BSD-3-Clause)
/*
 * Copyright (C) Lothar Waßmann <LW@KARO-electronics.de>
 */

/dts-v1/;

#include "stm32mp153a-txmp.h"
#include "stm32mp153-karo.dtsi"
#include "stm32mp153-txmp.dtsi"

/ {
	model = "Ka-Ro electronics GmbH TXMP-1530 module";
	compatible = "karo,stm32mp153a-txmp-1530", "st,stm32mp153";
};
