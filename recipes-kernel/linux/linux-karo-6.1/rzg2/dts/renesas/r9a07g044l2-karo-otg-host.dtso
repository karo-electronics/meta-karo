// SPDX-License-Identifier: (GPL-2.0-only OR BSD-3-Clause)
/*
 * Copyright (C) 2023 Markus Bauer <MB@karo-electronics.com>
 */
/dts-v1/;
/plugin/;

&{/chosen} {
	overlays {
		karo-otg-host;
	};
};

&hsusb {
	dr_mode = "host";
};
