// SPDX-License-Identifier: (GPL-2.0 OR BSD-3-Clause)
/*
 * Copyright (C) 2022 Lothar Waßmann <LW@KARO-electronics.de>
 */

/ {
	#address-cells = <1>;
	#size-cells = <0>;

	fragment@300 {
		reg = <0x300>;
		target = <&i2c6>;

		__overlay__ {
			#address-cells = <1>;
			#size-cells = <0>;
			status = "okay";

			touchpanel@38 {
				compatible = "edt,edt-ft5x06";
				reg = <0x38>;
				wakeup-source;
				status = "okay";
			};
		};
	};
};
