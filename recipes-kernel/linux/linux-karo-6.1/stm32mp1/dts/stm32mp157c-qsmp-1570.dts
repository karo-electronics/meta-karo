// SPDX-License-Identifier: (GPL-2.0-only OR BSD-3-Clause)
/*
 * Copyright (C) 2020 Lothar Waßmann <LW@KARO-electronics.de>
 */

/dts-v1/;

#include <dt-bindings/pinctrl/stm32-pinfunc.h>
#include "stm32mp157.dtsi"
#include "stm32mp15xc.dtsi"
#include "stm32mp15xxac-pinctrl.dtsi"
#include "stm32mp157c-qsmp-scmi.dtsi"

/ {
	model = "Ka-Ro electronics GmbH QSMP-1570 solder-in module";
	compatible = "karo,stm32mp157c-qsmp-1570", "karo,qsmp", "st,stm32mp157";
};
