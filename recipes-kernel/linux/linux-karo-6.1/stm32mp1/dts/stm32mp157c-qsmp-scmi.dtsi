// SPDX-License-Identifier: (GPL-2.0+ OR BSD-3-Clause)
/*
 * Copyright (C) 2024 Lothar Waßmann <LW@KARO-electronics.de>
 */

#include "stm32mp157c-karo-scmi.dtsi"
#include "stm32mp157-qsmp.dtsi"

&gpioz {
	clocks = <&scmi_clk CK_SCMI_GPIOZ>;
};
