// SPDX-License-Identifier: (GPL-2.0-or-later OR BSD-3-Clause)
/*
 * Copyright (C) 2024 Lothar Waßmann <LW@KARO-electronics.de>
 *
 */

#include "stm32mp15-karo-scmi.dtsi"

&cpu1 {
	clocks = <&scmi_clk CK_SCMI_MPU>;
};

&m_can1 {
	clocks = <&scmi_clk CK_SCMI_HSE>, <&rcc FDCAN_K>;
};

&m_can2 {
	clocks = <&scmi_clk CK_SCMI_HSE>, <&rcc FDCAN_K>;
};
