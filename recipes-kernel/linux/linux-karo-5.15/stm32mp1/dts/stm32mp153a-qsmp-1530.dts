// SPDX-License-Identifier: (GPL-2.0 OR BSD-3-Clause)
/*
 * Copyright (C) 2020 Lothar Waßmann <LW@KARO-electronics.de>
 */

/dts-v1/;

#include "stm32mp153.dtsi"
#include "stm32mp15xa.dtsi"
#include "stm32mp153-qsmp.dtsi"

/ {
	model = "Ka-Ro electronics GmbH QSMP-1530 solder-in module";
	compatible = "karo,stm32mp153a-qsmp-1530", "karo,qsmp", "st,stm32mp153";
};
