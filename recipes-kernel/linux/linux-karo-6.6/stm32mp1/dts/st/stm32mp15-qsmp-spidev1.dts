// SPDX-License-Identifier: (GPL-2.0 OR BSD-3-Clause)
/*
 * Copyright (C) 2025 Lothar Waßmann <LW@KARO-electronics.de>
 */

/dts-v1/;

/plugin/;

#include <dt-bindings/gpio/gpio.h>

&{/chosen} {
	overlays {
		qsmp-spidev1;
	};
};

&spi4 {
	cs-gpios = <
		    &gpioe 11 GPIO_ACTIVE_LOW
	>;
	status = "okay";

	spidev@0 {
		compatible = "karo,spidev-test";
		reg = <0>;
	};
};
