// SPDX-License-Identifier: (GPL-2.0-only OR BSD-3-Clause)
/*
 * Copyright (C) 2025 Marcel Mertens <MM@KARO-electronics.de>
 */

/dts-v1/;

#include <dt-bindings/pinctrl/stm32-pinfunc.h>
#include "stm32mp157.dtsi"
#include "stm32mp15xc.dtsi"
#include "stm32mp15xxac-pinctrl.dtsi"
#include "stm32mp157-qsmp.dtsi"
#include "stm32mp157c-karo-scmi.dtsi"
#include "stm32mp157c-qsmp-scmi.dtsi"

/ {
	model = "Ka-Ro electronics GmbH QSMP-1570W solder-in module";
	compatible = "karo,stm32mp157c-qsmp-1570w", "karo,qsmp", "st,stm32mp157";
};
