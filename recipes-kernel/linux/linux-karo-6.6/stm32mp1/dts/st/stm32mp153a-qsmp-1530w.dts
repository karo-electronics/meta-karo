// SPDX-License-Identifier: (GPL-2.0-only OR BSD-3-Clause)
/*
 * Copyright (C) 2025 Marcel Mertens <MM@KARO-electronics.de>
 */

/dts-v1/;

#include <dt-bindings/pinctrl/stm32-pinfunc.h>
#include "stm32mp153.dtsi"
#include "stm32mp15xa.dtsi"
#include "stm32mp15xxac-pinctrl.dtsi"
#include "stm32mp153-qsmp.dtsi"
#include "stm32mp153a-karo-scmi.dtsi"
#include "stm32mp153a-qsmp-scmi.dtsi"

/ {
	model = "Ka-Ro electronics GmbH QSMP-1530W solder-in module";
	compatible = "karo,stm32mp153a-qsmp-1530w", "karo,qsmp", "st,stm32mp153";
};
