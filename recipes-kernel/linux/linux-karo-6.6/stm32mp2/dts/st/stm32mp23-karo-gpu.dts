// SPDX-License-Identifier: (GPL-2.0-only OR BSD-3-Clause)
/*
 * Copyright (C) 2022 Lothar Waßmann <LW@KARO-electronics.de>
 */

/dts-v1/;

/plugin/;

&{/chosen} {
	overlays {
		karo-gpu;
	};
};

&gpu {
	contiguous-area = <&gpu_reserved>;
	status = "okay";
};
