// SPDX-License-Identifier: (GPL-2.0-only OR BSD-3-Clause)
/*
 * Copyright (C) 2024 Markus Bauer <MB@KARO-electronics.de>
 */

/dts-v1/;
/plugin/;

#include <dt-bindings/gpio/gpio.h>
#include <dt-bindings/interrupt-controller/arm-gic.h>

&{/chosen} {
	overlays {
		qsmp-ft5x06;
	};
};

&i2c4 {
	status = "okay";

	touchpanel@38 {
		compatible = "edt,edt-ft5x06";
		reg = <0x38>;
		interrupt-parent = <&gpiod>;
		interrupts = <12 IRQ_TYPE_EDGE_FALLING>;
		wakeup-source;
		status = "okay";
	};
};
