// SPDX-License-Identifier: (GPL-2.0-only OR BSD-3-Clause)
/*
 * Copyright (C) 2024 Lothar Waßmann <LW@KARO-electronics.de>
 */

&i2c3 {
	status = "okay";

	touchpanel0: touchpanel@38 {
		compatible = "edt,edt-ft5x06";
		reg = <0x38>;
		wakeup-source;
		status = "okay";
	};
};
