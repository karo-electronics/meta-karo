// SPDX-License-Identifier: (GPL-2.0 OR BSD-3-Clause)
/*
 * Copyright (C) 2024 Lothar Waßmann <LW@KARO-electronics.de>
 */

/dts-v1/;

/plugin/;

#include <dt-bindings/gpio/gpio.h>

&{/chosen} {
	overlays {
		qsmp-spidev2;
	};
};

&spi7 {
	cs-gpios = <
		    &gpioa 8 GPIO_ACTIVE_LOW
	>;
	status = "okay";

	spidev@0 {
		compatible = "karo,spidev-test";
		reg = <0>;
	};
};
