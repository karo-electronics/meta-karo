// SPDX-License-Identifier: (GPL-2.0-only OR BSD-3-Clause)
/*
 * Copyright (C) 2022 Lothar Waßmann <LW@KARO-electronics.de>
 */

/dts-v1/;

/plugin/;

&{/chosen} {
	overlays {
		karo-gpu;
	};
};

&gpu {
	contiguous-area = <&gpu_reserved>;
	power-domains = <&scmi_devpd 0>, <&d1_pd>;
	power-domain-names = "scmi_devpd", "d1_pd";
	status = "okay";
};
