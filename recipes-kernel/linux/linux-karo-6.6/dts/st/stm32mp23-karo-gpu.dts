// SPDX-License-Identifier: (GPL-2.0-only OR BSD-3-Clause)
/*
 * Copyright (C) 2025 Marcel Mertens <MM@KARO-electronics.de>
 */

/dts-v1/;

/plugin/;

&{/chosen} {
	overlays {
		karo-gpu;
	};
};

&gpu {
	contiguous-area = <&gpu_reserved>;
	status = "okay";
};
