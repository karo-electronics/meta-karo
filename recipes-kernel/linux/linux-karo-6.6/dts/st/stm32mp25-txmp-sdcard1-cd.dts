// SPDX-License-Identifier: (GPL-2.0-only OR BSD-3-Clause)
/*
 * Copyright (C) 2024 Lothar Waßmann <LW@KARO-electronics.de>
 */

#include <dt-bindings/gpio/gpio.h>

/dts-v1/;

/plugin/;

&{/chosen} {
	overlays {
		txmp-sdcard1-cd;
	};
};

&sdmmc1 {
	cd-gpios = <&gpiob 5 (GPIO_ACTIVE_LOW | GPIO_PULL_UP)>;
	status = "okay";
};
