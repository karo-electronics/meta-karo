/*
 * Copyright 2016 Lothar Waßmann <LW@KARO-electronics.de>
 * Copyright 2017 Oliver Wendt <OW@KARO-electronics.de>
 * Copyright 2016 Michael Vyskocil <MV@KARO-electronics.de>
 *
 * This file is dual-licensed: you can use it either under the terms
 * of the GPL or the X11 license, at your option. Note that this dual
 * licensing only applies to this file, and not this project as a
 * whole.
 *
 *  a) This file is free software; you can redistribute it and/or
 *     modify it under the terms of the GNU General Public License
 *     version 2 as published by the Free Software Foundation.
 *
 *     This file is distributed in the hope that it will be useful,
 *     but WITHOUT ANY WARRANTY; without even the implied warranty of
 *     MERCHANTABILITY or FITNESS FOR A PARTICULAR PURPOSE.  See the
 *     GNU General Public License for more details.
 *
 * Or, alternatively,
 *
 *  b) Permission is hereby granted, free of charge, to any person
 *     obtaining a copy of this software and associated documentation
 *     files (the "Software"), to deal in the Software without
 *     restriction, including without limitation the rights to use,
 *     copy, modify, merge, publish, distribute, sublicense, and/or
 *     sell copies of the Software, and to permit persons to whom the
 *     Software is furnished to do so, subject to the following
 *     conditions:
 *
 *     The above copyright notice and this permission notice shall be
 *     included in all copies or substantial portions of the Software.
 *
 *     THE SOFTWARE IS PROVIDED "AS IS", WITHOUT WARRANTY OF ANY KIND,
 *     EXPRESS OR IMPLIED, INCLUDING BUT NOT LIMITED TO THE WARRANTIES
 *     OF MERCHANTABILITY, FITNESS FOR A PARTICULAR PURPOSE AND
 *     NONINFRINGEMENT. IN NO EVENT SHALL THE AUTHORS OR COPYRIGHT
 *     HOLDERS BE LIABLE FOR ANY CLAIM, DAMAGES OR OTHER LIABILITY,
 *     WHETHER IN AN ACTION OF CONTRACT, TORT OR OTHERWISE, ARISING
 *     FROM, OUT OF OR IN CONNECTION WITH THE SOFTWARE OR THE USE OR
 *     OTHER DEALINGS IN THE SOFTWARE.
 */

/*
 * Please be reminded that in general DTSI file(s) are include files that are
 * for more than one purpose (usually bound to a SoC) and as such shouldn't be
 * edited. For end-user products it should be the DTS file(s) that choose which
 * devices and pins are active and setup.
 *
 * The setup of DT files for Ka-Ro TX COM Modules under Yocto follow a
 * different, non-standard, implementation, which can make it necessary.
 */

/*
 * Please see the imx6*-tx6-gpio.h && imx6*-tx6.dtsi in "linux-karo-x.y.ab/tx6"
 * for the definitions like TX_NAND or TX_EMMC, etc.
 */

/ {
	aliases {
		backlight = &backlight0;
		backlight0 = &backlight0;
		/*
		* The node/alias 'display' is needed for U-Boot to be able to
		* show a logo/splash image at boot time. It needs to include
		* 'display-timings' as direct sub-node.
		*/
		display = TX_LCD;
		mxcfb0 = TX_LCD_FB;
	};

	backlight0: backlight0 {
		compatible = "pwm-backlight";
		pwms = <TX_PWM 0 500000>;
		power-supply = <&reg_lcd0_pwr>;
		/*
		* a poor man's way to create a 1:1 relationship between
		* the PWM value and the actual duty cycle
		*/
		brightness-levels = < 0  1  2  3  4  5  6  7  8  9
				     10 11 12 13 14 15 16 17 18 19
				     20 21 22 23 24 25 26 27 28 29
				     30 31 32 33 34 35 36 37 38 39
				     40 41 42 43 44 45 46 47 48 49
				     50 51 52 53 54 55 56 57 58 59
				     60 61 62 63 64 65 66 67 68 69
				     70 71 72 73 74 75 76 77 78 79
				     80 81 82 83 84 85 86 87 88 89
				     90 91 92 93 94 95 96 97 98 99
				    100>;
		default-brightness-level = <50>;
		status = "disabled";
	};

	leds {
		compatible = "gpio-leds";
		pinctrl-names = "default";
		pinctrl-0 = <&pinctrl_gpio_leds>;

		user_led: user {
			label = "Heartbeat";
			gpios = <TX_GPIO_PIN153 GPIO_ACTIVE_HIGH>;
			linux,default-trigger = "heartbeat";
		};
	};

	regulators {
		reg_2v5: regulator {
			compatible = "regulator-fixed";
			reg = <1>;
			regulator-name = "2V5";
			regulator-min-microvolt = <2500000>;
			regulator-max-microvolt = <2500000>;
			regulator-always-on;
		};

		reg_3v3: regulator {
			compatible = "regulator-fixed";
			reg = <2>;
			regulator-name = "3V3";
			regulator-min-microvolt = <3300000>;
			regulator-max-microvolt = <3300000>;
			regulator-always-on;
		};

		reg_lcd0_pwr: regulator-lcd-power {
			compatible = "regulator-fixed";
			regulator-name = "LCD0 RESET";
			regulator-min-microvolt = <3300000>;
			regulator-max-microvolt = <3300000>;
			pinctrl-names = "default";
			pinctrl-0 = <&pinctrl_lcd0_pwr>;
			gpio = <TX_GPIO_PIN150 GPIO_ACTIVE_HIGH>;
			enable-active-high;
			regulator-boot-on;
			regulator-always-on;
		};
	};

	sound {
		compatible = "fsl,imx-audio-sgtl5000";
		model = "sgtl5000-audio";
		pinctrl-names = "default";
		pinctrl-0 = <TX_SSI_PIN>;
		ssi-controller = <&ssi1>;
		audio-codec = <&sgtl5000>;
		audio-routing =
			"MIC_IN", "Mic Jack",
			"Mic Jack", "Mic Bias",
			"Headphone Jack", "HP_OUT";
		mux-int-port = <1>;
		mux-ext-port = <5>;
		status = "okay";
	};
};

TX_CAN1 {
	status = "okay";
};

TX_I2C {
	status = "okay";

	sgtl5000: sgtl5000@0a {
		compatible = "fsl,sgtl5000";
		reg = <0x0a>;
		VDDA-supply = <&reg_2v5>;
		VDDIO-supply = <&reg_3v3>;
		clocks = <&mclk>;
	};

	polytouch: edt-ft5x06@38 {
		compatible = "edt,edt-ft5x06";
		reg = <0x38>;
		pinctrl-names = "default";
		pinctrl-0 = <&pinctrl_edt_ft5x06>;
		interrupts-extended = <TX_GPIO_PIN148 0>;
		reset-gpios = <TX_GPIO_PIN149 GPIO_ACTIVE_LOW>;
		wake-gpios = <TX_GPIO_PIN152 GPIO_ACTIVE_HIGH>;
		linux,wakeup;
	};
};

TX_LCD {
/*
 * The node/alias 'display' is needed for U-Boot to be able to show a
 * logo/splash image at boot time. It needs to include 'display-timings'
 * as direct sub-node.
 *
 * Other naming is only needed for the NXP/Freescale non-mainline
 * compliant/proprietary display driver in their Yocto 4.1 Kernel
 * implementation.
 */
	compatible = "fsl,lcd";
	ipu_id = <0>;
	disp_id = <0>;
	default_ifmt = "RGB565";
	pinctrl-names = "default";
	pinctrl-0 = <&pinctrl_ipu1>;
	status = "disabled";
	display-timings {
		VGA {
			clock-frequency = <25200000>;
			hactive = <640>;
			vactive = <480>;
			hback-porch = <48>;
			hsync-len = <96>;
			hfront-porch = <16>;
			vback-porch = <31>;
			vsync-len = <2>;
			vfront-porch = <12>;
			hsync-active = <0>;
			vsync-active = <0>;
			de-active = <1>;
			pixelclk-active = <0>;
		};

		ETV570 {
			clock-frequency = <25200000>;
			hactive = <640>;
			vactive = <480>;
			hback-porch = <114>;
			hsync-len = <30>;
			hfront-porch = <16>;
			vback-porch = <32>;
			vsync-len = <3>;
			vfront-porch = <10>;
			hsync-active = <0>;
			vsync-active = <0>;
			de-active = <1>;
			pixelclk-active = <0>;
		};

		ET0350 {
			clock-frequency = <6413760>;
			hactive = <320>;
			vactive = <240>;
			hback-porch = <34>;
			hsync-len = <34>;
			hfront-porch = <20>;
			vback-porch = <15>;
			vsync-len = <3>;
			vfront-porch = <4>;
			hsync-active = <0>;
			vsync-active = <0>;
			de-active = <1>;
			pixelclk-active = <0>;
		};

		ET0430 {
			clock-frequency = <9009000>;
			hactive = <480>;
			vactive = <272>;
			hback-porch = <2>;
			hsync-len = <41>;
			hfront-porch = <2>;
			vback-porch = <2>;
			vsync-len = <10>;
			vfront-porch = <2>;
			hsync-active = <0>;
			vsync-active = <0>;
			de-active = <1>;
			pixelclk-active = <1>;
		};

		ET0500 {
			clock-frequency = <33264000>;
			hactive = <800>;
			vactive = <480>;
			hback-porch = <88>;
			hsync-len = <128>;
			hfront-porch = <40>;
			vback-porch = <33>;
			vsync-len = <2>;
			vfront-porch = <10>;
			hsync-active = <0>;
			vsync-active = <0>;
			de-active = <1>;
			pixelclk-active = <0>;
		};

		ET0700 { /* same as ET0500 */
			clock-frequency = <33264000>;
			hactive = <800>;
			vactive = <480>;
			hback-porch = <88>;
			hsync-len = <128>;
			hfront-porch = <40>;
			vback-porch = <33>;
			vsync-len = <2>;
			vfront-porch = <10>;
			hsync-active = <0>;
			vsync-active = <0>;
			de-active = <1>;
			pixelclk-active = <0>;
		};

		ETQ570 {
			clock-frequency = <6596040>;
			hactive = <320>;
			vactive = <240>;
			hback-porch = <38>;
			hsync-len = <30>;
			hfront-porch = <30>;
			vback-porch = <16>;
			vsync-len = <3>;
			vfront-porch = <4>;
			hsync-active = <0>;
			vsync-active = <0>;
			de-active = <1>;
			pixelclk-active = <0>;
		};
	};
};

TX_LCD_FB {
	compatible = "fsl,mxc_sdc_fb";
	disp_dev = "lcd";
	interface_pix_fmt = "RGB24";
	default_bpp = <16>;
	int_clk = <0>;
	late_init = <0>;
	status = "disabled";
};

TX_PWM {
	status = "okay";
};

TX_SD1 {
	status = "okay";
};

TX_SSI1 {
	status = "okay";
};

TX_UART1 {
	status = "okay";
};

TX_UART2 {
	status = "okay";
	fsl,uart-has-rtscts;
	uart-has-rtscts;
};

TX_UART3 {
	status = "okay";
};

TX_USBH {
	status = "okay";
};

TX_USBOTG {
	status = "okay";
};

&iomuxc {
	tx6 {
		pinctrl_edt_ft5x06: edt-ft5x06grp {
			fsl,pins = <
				TX_GPIO_PAD148		/* Interrupt */
				TX_GPIO_PAD149		/* Reset */
				TX_GPIO_PAD152		/* Wake */
			>;
		};

		pinctrl_gpio_leds: gpioledsgrp {
			fsl,pins = <
				TX_GPIO_PAD153		/* LED Heartbeat */
			>;
		};

		pinctrl_lcd0_pwr: lcd0-pwrgrp {
			fsl,pins = <
				TX_GPIO_PAD150		/* LCD Reset */
			>;
		};
	};
};
