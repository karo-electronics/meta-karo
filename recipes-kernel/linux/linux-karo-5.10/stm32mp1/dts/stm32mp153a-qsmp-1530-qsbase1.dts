// SPDX-License-Identifier: GPL-2.0 OR BSD-3-Clause
/*
 * Copyright (C) 2020 Lothar Waßmann <LW@KARO-electronics.de>
 */

#include "stm32mp153a-qsmp-1530.dts"
#include "stm32mp15-karo-qsbase1.dtsi"

/ {
	model = "Ka-Ro electronics GmbH QSMP-1530 module on QSBASE1 baseboard";
};

&phy0 {
	rxd0-skew-ps = <(420 + 6)>;
	rxd1-skew-ps = <(420 + 5)>;
	rxd2-skew-ps = <(420 - 1)>;
	rxd3-skew-ps = <(420 - 22)>;
	txd0-skew-ps = <(420 - 103)>;
	txd1-skew-ps = <(420 - 104)>;
	txd2-skew-ps = <(420 - 73)>;
	txd3-skew-ps = <(420 - 25)>;
	txen-skew-ps = <(420 + 15)>;
	rxdv-skew-ps = <(420 - 12)>;
	rxc-skew-ps = <(900 + 0)>;
	txc-skew-ps = <(900 + 1000)>;
};
