// SPDX-License-Identifier: (GPL-2.0 OR BSD-3-Clause)
/*
 * Copyright (C) 2020 Lothar Waßmann <LW@KARO-electronics.de>
 */

/dts-v1/;

#include "stm32mp157.dtsi"
#include "stm32mp15xc.dtsi"
#include "stm32mp157-qsmp.dtsi"

/ {
	model = "Ka-Ro electronics GmbH QSMP-1570 solder-in module";
	compatible = "karo,stm32mp157c-qsmp-1570", "st,stm32mp157";
};
