// SPDX-License-Identifier: GPL-2.0 OR BSD-3-Clause
/*
 * Copyright (C) 2020 Markus Bauer <mb@karo-electronics.de>
 */

/dts-v1/;

#include "stm32mp153a-qsmp-1530.dts"
#include "stm32mp15-karo-qsbase2.dtsi"

/ {
	model = "Ka-Ro electronics GmbH QSMP-1530 module on QSBASE2 baseboard";
};
