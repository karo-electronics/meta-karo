// SPDX-License-Identifier: GPL-2.0 OR BSD-3-Clause
/*
 * Copyright (C) 2022 Markus Bauer <MB@KARO-electronics.de>
 */

#include "stm32mp157c-qsmp-1570.dts"
#include "stm32mp15-karo-qsbase4.dtsi"

/ {
	model = "Ka-Ro electronics GmbH QSMP-1570 module on QSBASE4 baseboard";
};
