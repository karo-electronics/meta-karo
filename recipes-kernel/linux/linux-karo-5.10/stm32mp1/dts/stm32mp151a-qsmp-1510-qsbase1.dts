// SPDX-License-Identifier: GPL-2.0 OR BSD-3-Clause
/*
 * Copyright (C) 2020 Lothar Waßmann <LW@KARO-electronics.de>
 */

#include "stm32mp151a-qsmp-1510.dts"
#include "stm32mp15-karo-qsbase1.dtsi"
#include "stm32mp15-qsmp-lcd-panel.dtsi"

/ {
	model = "Ka-Ro electronics GmbH QSMP-1510 module on QSBASE1 baseboard";
};
