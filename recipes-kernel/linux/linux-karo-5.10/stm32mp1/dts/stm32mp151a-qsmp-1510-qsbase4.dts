// SPDX-License-Identifier: (GPL-2.0 OR BSD-3-Clause)
/*
 * Copyright (C) 2022 Lothar Waßmann <LW@KARO-electronics.de>
 */

#include "stm32mp151a-qsmp-1510.dts"
#include "stm32mp15-karo-qsbase4.dtsi"

/ {
	model = "Ka-Ro electronics GmbH QSMP-1510 module on QSBASE4 baseboard";
};
