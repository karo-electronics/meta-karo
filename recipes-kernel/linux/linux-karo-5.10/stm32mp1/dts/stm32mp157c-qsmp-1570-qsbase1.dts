// SPDX-License-Identifier: GPL-2.0 OR BSD-3-Clause
/*
 * Copyright (C) 2020 Lothar Waßmann <LW@KARO-electronics.de>
 */

#include "stm32mp157c-qsmp-1570.dts"
#include "stm32mp15-karo-qsbase1.dtsi"
#include "stm32mp15-qsmp-lcd-panel.dtsi"

/ {
	model = "Ka-Ro electronics GmbH QSMP-1570 module on QSBASE1 baseboard";
};

&gpu {
	status = "okay";
};
