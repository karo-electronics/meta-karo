// SPDX-License-Identifier: (GPL-2.0 OR BSD-3-Clause)
/*
 * Copyright (C) 2023 Markus Bauer <MB@karo-electronics.com>
 */
/dts-v1/;
/plugin/;

#include "r9a07g044l2-karo-lcd-panel.dtsi"

&{/chosen} {
	overlays {
		txrz-lvds-panel;
	};
};

&lcd_panel {
	enable-gpios = <&pinctrl RZG2L_GPIO(4, 1) GPIO_ACTIVE_HIGH>;
};
