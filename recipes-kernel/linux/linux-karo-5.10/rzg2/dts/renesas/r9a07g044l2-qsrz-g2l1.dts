// SPDX-License-Identifier: GPL-2.0
/*
 * Device Tree Source for the RZG2L based Ka-Ro QSRZ-G2L0 CoM
 *
 * Copyright (C) 2022 Markus Bauer <MB@karo-electronics.com>
 */

/dts-v1/;
#include "r9a07g044l2-qsrz.dtsi"

/ {
	model = "Ka-Ro electronics GmbH RZ/G2L(r9a07g044l2) based QSRZ-G2L1 CoM";
	compatible = "karo,qsrz-g2l1", "renesas,r9a07g044l2", "renesas,r9a07g044";

	memory@48000000 {
		device_type = "memory";
		/* first 128MB is reserved for secure area. */
		reg = <0 0x48000000 0 0x18000000>;
	};
};
