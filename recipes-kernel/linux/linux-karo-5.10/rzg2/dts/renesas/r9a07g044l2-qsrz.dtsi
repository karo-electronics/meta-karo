// SPDX-License-Identifier: (GPL-2.0 OR BSD-3-Clause)
/*
 * Device Tree Include for the RZG2L based Ka-Ro QSRZ CoMs
 *
 * Copyright (C) 2022 Markus Bauer <MB@karo-electronics.com>
 */

#include "r9a07g044l2-karo.dtsi"
