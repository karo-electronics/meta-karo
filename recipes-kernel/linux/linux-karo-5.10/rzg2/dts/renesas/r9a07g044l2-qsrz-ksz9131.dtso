// SPDX-License-Identifier: (GPL-2.0 OR BSD-3-Clause)
/*
 * Copyright (C) 2023 Markus Bauer <MB@karo-electronics.com>
 */
/dts-v1/;
/plugin/;

#include <dt-bindings/gpio/gpio.h>
#include <dt-bindings/pinctrl/rzg2l-pinctrl.h>
#include <dt-bindings/interrupt-controller/arm-gic.h>

&eth0 {
	pinctrl-names = "default";
	pinctrl-0 = <&eth0_pins>;
	phy-handle = <&phy0>;
	phy-mode = "rgmii-id";
	status = "okay";

	phy0: phy@7 {
		reg = <7>;
		interrupt-parent = <&pinctrl>;
		interrupts = <RZG2L_GPIO(22, 1) IRQ_TYPE_EDGE_FALLING>;
		micrel,force-master;
	};
};

&pinctrl {
	eth0_pins: eth0grp {
		pinmux = <
			  RZG2L_PORT_PINMUX(28, 0, 1)	/* ET0_MDIO */
			  RZG2L_PORT_PINMUX(27, 1, 1)	/* ET0_MDC */
			  RZG2L_PORT_PINMUX(24, 0, 1)	/* ET0_RXC */
			  RZG2L_PORT_PINMUX(24, 1, 1)	/* ET0_RX_CTL */
			  RZG2L_PORT_PINMUX(25, 0, 1)	/* ET0_RXD0 */
			  RZG2L_PORT_PINMUX(25, 1, 1)	/* ET0_RXD1 */
			  RZG2L_PORT_PINMUX(26, 0, 1)	/* ET0_RXD2 */
			  RZG2L_PORT_PINMUX(26, 1, 1)	/* ET0_RXD3 */
			  RZG2L_PORT_PINMUX(20, 1, 1)	/* ET0_TX_CTL */
			  RZG2L_PORT_PINMUX(20, 0, 1)	/* ET0_TXC */
			  RZG2L_PORT_PINMUX(22, 0, 1)	/* ET0_TXD3 */
			  RZG2L_PORT_PINMUX(21, 1, 1)	/* ET0_TXD2 */
			  RZG2L_PORT_PINMUX(21, 0, 1)	/* ET0_TXD1 */
			  RZG2L_PORT_PINMUX(20, 2, 1)	/* ET0_TXD0 */
		>;
	};
};
