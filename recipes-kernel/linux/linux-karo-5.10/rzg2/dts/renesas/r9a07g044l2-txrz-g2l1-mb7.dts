// SPDX-License-Identifier: (GPL-2.0 OR BSD-3-Clause)
/*
 * Device Tree Source for the RZG2L based Ka-Ro TXRZ-G2L0 CoM on MB7
 *
 * Copyright (C) 2022 Markus Bauer <MB@karo-electronics.com>
 */

/dts-v1/;
#include "r9a07g044l2-txrz-g2l1.dts"
#include "r9a07g044l2-txrz-mb7.dtsi"

/ {
	model = "Ka-Ro electronics GmbH RZ/G2L(r9a07g044l2) based TXRZ-G2L1 CoM on TX Mainboard 7";
};
