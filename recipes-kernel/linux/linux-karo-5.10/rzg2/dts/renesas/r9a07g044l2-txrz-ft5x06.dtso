// SPDX-License-Identifier: (GPL-2.0 OR BSD-3-Clause)
/*
 * Copyright (C) 2023 Markus Bauer <MB@karo-electronics.com>
 */
/dts-v1/;
/plugin/;

#include <dt-bindings/gpio/gpio.h>
#include <dt-bindings/pinctrl/rzg2l-pinctrl.h>
#include <dt-bindings/interrupt-controller/arm-gic.h>

&{/chosen} {
	overlays {
		txrz-ft5x06;
	};
};

&i2c1 {
	polytouch: touch-controller@38 {
		compatible = "edt,edt-ft5x06";
		reg = <0x38>;
		interrupt-parent = <&pinctrl>;
		interrupts = <RZG2L_GPIO(42, 2) IRQ_TYPE_EDGE_FALLING>;
		reset-gpios = <&pinctrl RZG2L_GPIO(42, 3) GPIO_ACTIVE_LOW>;
		wake-gpios = <&pinctrl RZG2L_GPIO(47, 3) GPIO_ACTIVE_HIGH>;
		wakeup-source;
		status = "okay";
	};
};
