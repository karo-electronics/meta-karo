## conf/machine/include/tx-base.inc
```bitbake
TCMODE = "${@ 'default' if d.getVar('UBOOT_MACHINE') == None else 'uboot'}"

KBUILD_BUILD_USER := "support"
KBUILD_BUILD_HOST := "karo-electronics.de"

# Set specific make target and binary suffix
PREFERRED_PROVIDER_u-boot ??= "u-boot-karo"
PREFERRED_PROVIDER_virtual/bootloader ??= "u-boot-karo"

UBOOT_MAKE_TARGET ??= "u-boot.bin"
UBOOT_SUFFIX ??= "bin"

UBOOT_ENTRYPOINT_mx6  = "0x10008000"
UBOOT_ENTRYPOINT_mx6ul = "0x80008000"

# 'cortexa9-neon' 'cortexa9hf-neon'
DEFAULTTUNE_mx6 ?= "cortexa9hf-neon"
DEFAULTTUNE_mx6ul ?= "cortexa7hf-neon"

PREFERRED_PROVIDER_virtual/xserver = "xserver-xorg"
XSERVER_DRIVER = "xf86-video-fbdev"
XSERVER_DRIVER_mx6 = "xf86-video-modesetting"
XSERVER = "xserver-xorg \
           xf86-input-evdev \
           ${XSERVER_DRIVER}"

PACKAGE_EXCLUDE_COMPLEMENTARY = ".*"

PREFERRED_PROVIDER_virtual/egl ?= "mesa"
PREFERRED_PROVIDER_virtual/libgles1 ?= "mesa"
PREFERRED_PROVIDER_virtual/libgles2 ?= "mesa"
PREFERRED_PROVIDER_virtual/libgl ?= "mesa"
PREFERRED_PROVIDER_virtual/libg2d_mx6 ?= "mesa"
PREFERRED_PROVIDER_virtual/libg2d_mx6ul ?= ""

PREFERRED_PROVIDER_virtual/kernel ??= "linux-karo"
PREFERRED_VERSION_linux-karo ?= "4.14.24"
KERNEL_IMAGETYPE = "uImage"

MACHINE_ESSENTIAL_EXTRA_RDEPENDS = " \
                 linux-firmware-imx-sdma-imx6q \
"
MACHINE_ESSENTIAL_EXTRA_RDEPENDS_append_karo-x11 = " \
                 linux-firmware-imx-vpu \
"

# Ship kernel modules
MACHINE_EXTRA_RRECOMMENDS = " \
                          kernel-modules \
"

SERIAL_CONSOLES = " \
                115200;ttymxc0 \
                115200;ttymxc1 \
                115200;ttymxc2 \
"
SERIAL_CONSOLES_mxs = " \
                115200;ttyAMA0 \
                115200;ttyAPP1 \
                115200;ttyAPP3 \
"

MACHINE_FEATURES = " \
                 alsa \
                 rtc \
                 serial \
                 touchscreen \
                 usbgadget \
                 usbhost \
                 vfat \
"

# Add the ability to specify _imx machines
MACHINEOVERRIDES =. "imx:"

# Default baseboard name
TXBASE_DEFAULT_mx6 ?= "mb7"
TXBASE_DEFAULT_mx6ul ?= "evalkit"

TXBASE ?= "${TXBASE_DEFAULT}"
```

## conf/machine/include/tx6-base.inc
```bitbake
include conf/machine/include/karo.inc

MACHINEOVERRIDES =. "mx6:"

UBOOT_MAKE_TARGET ??= "u-boot.bin"
UBOOT_SUFFIX ??= "bin"

UBOOT_ENTRYPOINT:tx6  ?= "0x10008000"
UBOOT_ENTRYPOINT:txul ?= "0x80008000"
UBOOT_CONFIG ??= "mfg generic"

# Ship imx-sdma & vpu firmware
MACHINE_ESSENTIAL_EXTRA_RDEPENDS = " \
        linux-firmware-imx-sdma-imx6q \
        linux-firmware-imx-vpu \
"

# Set Serial consoles
SERIAL_CONSOLES ?= "115200;ttymxc0 115200;ttymxc1 115200;ttymxc2"

KARO_BASEBOARD:mx6 = ""

DTB_BASENAME:mx6dl ?= "imx6dl-${MACHINE}"
DTB_BASENAME:mx6q ?= "imx6q-${MACHINE}"
DTB_BASENAME:mx6ul ?= "imx6ul-${MACHINE}"

KERNEL_DEVICETREE:append = "${@ " ${DTB_BASENAME}-${KARO_BASEBOARD}.dtb" if "${KARO_BASEBOARD}" != "" else ""}"
```

## conf/machine/include/tx8-base.inc
```bitbake
MACHINEOVERRIDES =. "mx8:mx8m:"

KBUILD_BUILD_USER := "support"
KBUILD_BUILD_HOST := "karo-electronics.de"

require conf/machine/include/arm/arch-arm64.inc

UBOOT_CONFIG ??= "mfg generic"

SPL_BINARY = "spl/u-boot-spl.bin"

# Set DDR FIRMWARE
DDR_FIRMWARE_NAME = "ddr3_imem_1d.bin ddr3_dmem_1d.bin"

# Set imx-mkimage boot target
IMXBOOT_TARGETS = "flash_tx8m"

# Set Serial consoles
SERIAL_CONSOLES = "115200;ttymxc0 115200;ttymxc1 115200;ttymxc2"

IMAGE_BOOTLOADER = "imx-boot"

BOOT_SPACE = "65536"

PREFERRED_PROVIDER_u-boot ?= "u-boot-karo"
PREFERRED_PROVIDER_virtual/bootloader ?= "u-boot-karo"

LOADADDR = ""
UBOOT_SUFFIX = "bin"
UBOOT_MAKE_TARGET = ""

# Kernel Configs
PREFERRED_PROVIDER_virtual/kernel ?= "linux-karo"
PREFERRED_VERSION_linux-karo ?= "5.4"
```

## conf/machine/include/txmp-base.inc
```bitbake
MACHINEOVERRIDES =. "stm32mp1:"

DEFAULTTUNE ?= "cortexa7thf-neon-vfpv4"

include karo.inc
include conf/machine/include/soc-family.inc
include conf/machine/include/arm/armv7a/tune-cortexa7.inc

SOC_PREFIX = "stm32mp15"

MACHINE_FEATURES:append = " emmc"

UBOOT_CONFIG ??= "mfg trusted"

UBOOT_ENTRYPOINT = "0xc0008000"

# Set Serial consoles
SERIAL_CONSOLES ?= "115200;ttySTM0 115200;ttySTM1 115200;ttySTM2"

# =========================================================================
# boot scheme
# =========================================================================
# List of supported boot schemes
BOOTSCHEME_LABELS ??= "trusted"

# =========================================================================
# tf-a
# =========================================================================
# Finally we must compile tf-a in all cases as we need trusted binary to boot
EXTRA_IMAGEDEPENDS += "firmware-pack tf-a-stm32mp"

# Define default TF-A config
# Set default TF-A config
TF_A_CONFIG = "serialboot"
TF_A_CONFIG:append = "${@bb.utils.contains('BOOTSCHEME_LABELS', 'trusted', ' trusted', '', d)}"

# Manage proper update for TF_A_CONFIG_* var
tfaconfig_env[vardeps] += "${@bb.utils.contains('TF_A_CONFIG', 'serialboot', 'TF_A_CONFIG_serialboot', '', d)}"
tfaconfig_env[vardeps] += "${@bb.utils.contains('TF_A_CONFIG', 'trusted', 'TF_A_CONFIG_trusted', '', d)}"

DTB_BASENAME ?= "${TF_A_DEVICETREE}"

FIPTOOL_DIR = "fiptool"

# coprocessor stuff
M4_BOARDS ?= "STM32MP157C-DK2"
```

## conf/machine/qs8m-mq00.conf
```bitbake
#@TYPE: Machine
#@NAME: Ka-Ro electronics NXP i.MX8MM QS8M-MQ00 Computer-On-Module
#@SOC: i.MX8MM
#@DESCRIPTION: Machine configuration for Ka-Ro electronics QS8M-MQ00 Computer-On-Module
#@MAINTAINER: Ka-Ro electronics GmbH <support@karo-electronics.com>

require include/tx8-base.inc

MACHINEOVERRIDES_append = "qs8m:mx8mm:qs8m-mq00:"

# u-boot configs
UBOOT_CONFIG[generic] = "qs8m-mq00_config"
UBOOT_CONFIG[noenv] = "qs8m-mq00_noenv_config"
UBOOT_CONFIG[mfg] = "qs8m-mq00_mfg_config"
UBOOT_CONFIG[secure-boot] = "qs8m-mq00_sec_config"

IMX_BOOT_SEEK = "33"

# Set U-Boot DTB
UBOOT_DTB_NAME = "imx8mm-qs8m-mq00.dtb"

# Ka-Ro specific Device Tree files to be compiled
KERNEL_DEVICETREE = " \
		     freescale/imx8mm-qs8m-mq00.dtb \
		     freescale/imx8mm-qs8m-mq00-qsbase2.dtb \
"
```

## conf/machine/qs8m-nd00.conf
```bitbake
#@TYPE: Machine
#@NAME: Ka-Ro electronics NXP i.MX8MN QS8M-ND00 Computer-On-Module
#@SOC: i.MX8MN
#@DESCRIPTION: Machine configuration for Ka-Ro electronics QS8M-ND00 Computer-On-Module
#@MAINTAINER: Ka-Ro electronics GmbH <support@karo-electronics.com>

require include/tx8-base.inc

MACHINEOVERRIDES_append = "qs8m:mx8mn:qs8m-nd00:"

# u-boot configs
UBOOT_CONFIG[generic] = "qs8m-nd00_config"
UBOOT_CONFIG[noenv] = "qs8m-nd00_noenv_config"
UBOOT_CONFIG[mfg] = "qs8m-nd00_mfg_config"
UBOOT_CONFIG[secure-boot] = "qs8m-nd00_sec_config"

IMX_BOOT_SEEK = "0"

# Set U-Boot DTB
UBOOT_DTB_NAME = "imx8mn-qs8m-nd00.dtb"

# Ka-Ro specific Device Tree files to be compiled
KERNEL_DEVICETREE = "freescale/imx8mn-qs8m-nd00.dtb"
```

## conf/machine/qsmp-1510.conf
```bitbake
#@TYPE: Machine
#@NAME: qsmp-1510
#@DESCRIPTION: Machine Configuration for Ka-Ro electronics GmbH's QSMP-1510 CoM

MACHINEOVERRIDES =. "stm32mp15:qsmp:"

include include/stm32mp1-base.inc

SOC_PREFIX = "stm32mp15"
SOC_FAMILY = "stm32mp151a"

IMAGE_CLASSES:remove = "st-partitions-image"

FLASHLAYOUT_CONFIG_LABELS = "spinand"

MACHINE_FEATURES:remove = "emmc"
MACHINE_FEATURES:append = " nand"

# =========================================================================
# U-Boot configs
# =========================================================================
UBOOT_CONFIG[trusted] = "qsmp-1510_trusted_defconfig,multivol_ubi,u-boot.bin"
UBOOT_CONFIG[noenv]   = "qsmp-1510_noenv_defconfig,multivol_ubi,u-boot.bin"
UBOOT_CONFIG[mfg] = "qsmp-1510_mfg_defconfig,multivol_ubi,u-boot.bin"

# Trusted Firmware
TF_A_DEVICETREE ?= "stm32mp151a-qsmp-1510"

# Kernel
KERNEL_DEVICETREE ?= " \
	stm32mp151a-qsmp-1510.dtb \
	stm32mp151a-qsmp-1510-qsbase1.dtb \
	stm32mp151a-qsmp-1510-qsbase4.dtb \
"

IMAGE_BOOT_FILES = ""
```

## conf/machine/tx6q-1030.conf
```bitbake
#@TYPE: Machine
#@NAME: Ka-Ro electronics TX6Q-1030
#@SOC: i.MX6Q
#@DESCRIPTION: Machine configuration for Ka-Ro electronics TX6Q-1030 Computer-On-Module
#@MAINTAINER: Ka-Ro electronics GmbH <support@karo-electronics.com>

require include/imx6q-tx6-nand.inc

KERNEL_DEVICETREE ?= "imx6q-tx6q-1010.dtb \
		      imx6q-tx6q-10x0-mb7.dtb \
"

UBOOT_CONFIG[generic] = "tx6q-10x0_config"
UBOOT_CONFIG[mfg] = "tx6q-10x0_mfg_config"
UBOOT_CONFIG[noenv] = "tx6q-10x0_noenv_config"
UBOOT_CONFIG[secure-boot] = "tx6q-10x0_sec_config"

MACHINEOVERRIDES =. "tx6q-1030:"
```

## conf/machine/tx6q-1036.conf
```bitbake
#@TYPE: Machine
#@NAME: Ka-Ro electronics TX6Q-1036
#@SOC: i.MX6Q
#@DESCRIPTION: Machine configuration for Ka-Ro electronics TX6Q-1036 Computer-On-Module
#@MAINTAINER: Ka-Ro electronics GmbH <support@karo-electronics.com>

require include/imx6q-tx6-emmc.inc

KERNEL_DEVICETREE ?= "imx6q-tx6q-1036.dtb \
		      imx6q-tx6q-1036-mb7.dtb \
"

UBOOT_CONFIG[generic] = "tx6q-1036_config"
UBOOT_CONFIG[mfg] = "tx6q-1036_mfg_config"
UBOOT_CONFIG[noenv] = "tx6q-1036_noenv_config"
UBOOT_CONFIG[secure-boot] = "tx6q-1036_sec_config"

MACHINEOVERRIDES =. "tx6q-1036:"
```

## conf/machine/tx6q-1130.conf
```bitbake
#@TYPE: Machine
#@NAME: Ka-Ro electronics TX6Q-1130
#@SOC: i.MX6Q
#@DESCRIPTION: Machine configuration for Ka-Ro electronics TX6Q-1130 Computer-On-Module
#@MAINTAINER: Ka-Ro electronics GmbH <support@karo-electronics.com>

DTB_BASENAME:mx6q ?= "${@ "imx6q-tx6q-11x0" if d.getVar('KARO_BASEBOARD') != "" else "imx6q-tx6q-1110"}"

require include/imx6q-tx6-nand.inc
require include/imx6qdl-tx6-lvds.inc

KERNEL_DEVICETREE ?= "imx6q-tx6q-1110.dtb \
                      imx6q-tx6q-11x0-mb7.dtb \
"

UBOOT_CONFIG[generic] = "tx6q-1130_config"
UBOOT_CONFIG[mfg] = "tx6q-1130_mfg_config"
UBOOT_CONFIG[noenv] = "tx6q-1130_noenv_config"
UBOOT_CONFIG[secure-boot] = "tx6q-1130_sec_config"
```

## conf/machine/tx6q-8037.conf
```bitbake
#@TYPE: Machine
#@NAME: Ka-Ro electronics TX6Q-8037
#@SOC: i.MX6QP
#@DESCRIPTION: Machine configuration for Ka-Ro electronics TX6Q-8037 Computer-On-Module
#@MAINTAINER: Ka-Ro electronics GmbH <support@karo-electronics.com>

require include/imx6qp-tx6-emmc.inc

KERNEL_DEVICETREE ?= "imx6qp-tx6q-8037.dtb \
                      imx6qp-tx6q-8037-mb7.dtb \
"

UBOOT_CONFIG[generic] = "tx6q-8037_config"
UBOOT_CONFIG[mfg] = "tx6q-8037_mfg_config"
UBOOT_CONFIG[noenv] = "tx6q-8037_noenv_config"
UBOOT_CONFIG[secure-boot] = "tx6q-8037_sec_config"
```

## conf/machine/tx6q-8137.conf
```bitbake
#@TYPE: Machine
#@NAME: Ka-Ro electronics TX6Q-8137
#@SOC: i.MX6QP
#@DESCRIPTION: Machine configuration for Ka-Ro electronics TX6Q-8137 Computer-On-Module
#@MAINTAINER: Ka-Ro electronics GmbH <support@karo-electronics.com>

require include/imx6qp-tx6-emmc.inc
require include/imx6qdl-tx6-lvds.inc

KERNEL_DEVICETREE ?= "imx6qp-tx6q-8137.dtb \
		      imx6qp-tx6q-8137-mb7.dtb \
"

UBOOT_CONFIG[generic] = "tx6qp-8137_config"
UBOOT_CONFIG[mfg] = "tx6qp-8137_mfg_config"
UBOOT_CONFIG[noenv] = "tx6qp-8137_noenv_config"
UBOOT_CONFIG[secure-boot] = "tx6qp-8137_sec_config"

MACHINEOVERRIDES =. "tx6q-8137:"
```

## conf/machine/tx6s-8035.conf
```bitbake
#@TYPE: Machine
#@NAME: Ka-Ro electronics i.MX6S TX6S-8035
#@SOC: i.MX6S
#@DESCRIPTION: Machine configuration for Ka-Ro electronics TX6S-8035 Computer-On-Module
#@MAINTAINER: Ka-Ro electronics GmbH <support@karo-electronics.com>

require include/imx6dl-tx6-emmc.inc

KERNEL_DEVICETREE ?= "imx6dl-tx6s-8035.dtb \
		      imx6dl-tx6s-8035-mb7.dtb \
"

UBOOT_CONFIG[generic] = "tx6s-8035_config"
UBOOT_CONFIG[mfg] = "tx6s-8035_mfg_config"
UBOOT_CONFIG[noenv] = "tx6s-8035_noenv_config"
UBOOT_CONFIG[secure-boot] = "tx6s-8035_sec_config"

MACHINEOVERRIDES =. "tx6s-8035:"
```

## conf/machine/tx6s-8134.conf
```bitbake
#@TYPE: Machine
#@NAME: Ka-Ro electronics i.MX6S TX6S-8134
#@SOC: i.MX6S
#@DESCRIPTION: Machine configuration for Ka-Ro electronics TX6S-8134 Computer-On-Module
#@MAINTAINER: Ka-Ro electronics GmbH <support@karo-electronics.com>

require include/imx6dl-tx6-nand.inc
require include/imx6qdl-tx6-lvds.inc

KERNEL_DEVICETREE ?= "imx6dl-tx6s-8134.dtb \
		      imx6dl-tx6s-8134-mb7.dtb \
"

UBOOT_CONFIG[generic] = "tx6s-8134_config"
UBOOT_CONFIG[mfg] = "tx6s-8134_mfg_config"
UBOOT_CONFIG[noenv] = "tx6s-8134_noenv_config"
UBOOT_CONFIG[secure-boot] = "tx6s-8134_sec_config"

MACHINEOVERRIDES =. "tx6s-8134:"
```

## conf/machine/tx6u-8030.conf
```bitbake
#@TYPE: Machine
#@NAME: Ka-Ro electronics i.MX6DL TX6U-8030
#@SOC: i.MX6DL
#@DESCRIPTION: Machine configuration for Ka-Ro electronics TX6U-8030 Computer-On-Module
#@MAINTAINER: Ka-Ro electronics GmbH <support@karo-electronics.com>

require include/imx6dl-tx6-nand.inc

KERNEL_DEVICETREE ?= "imx6dl-tx6u-801x.dtb \
		      imx6dl-tx6u-80xx-mb7.dtb \
"

UBOOT_CONFIG[generic] = "tx6u-80x0_config"
UBOOT_CONFIG[mfg] = "tx6u-80x0_mfg_config"
UBOOT_CONFIG[noenv] = "tx6u-80x0_noenv_config"
UBOOT_CONFIG[secure-boot] = "tx6u-80x0_sec_config"

MACHINEOVERRIDES =. "tx6u-8030:"
```

## conf/machine/tx6u-8033.conf
```bitbake
#@TYPE: Machine
#@NAME: Ka-Ro electronics TX6U-8033
#@SOC: i.MX6DL
#@DESCRIPTION: Machine configuration for Ka-Ro electronics TX6U-8033 Computer-On-Module
#@MAINTAINER: Ka-Ro electronics GmbH <support@karo-electronics.com>

require include/imx6dl-tx6-emmc.inc

KERNEL_DEVICETREE ?= "imx6dl-tx6u-8033.dtb \
		      imx6dl-tx6u-8033-mb7.dtb \
"

UBOOT_CONFIG[generic] = "tx6u-8033_config"
UBOOT_CONFIG[mfg] = "tx6u-8033_mfg_config"
UBOOT_CONFIG[noenv] = "tx6u-8033_noenv_config"
UBOOT_CONFIG[secure-boot] = "tx6u-8033_sec_config"

MACHINEOVERRIDES =. "tx6u-8033:"
```

## conf/machine/tx6u-8130.conf
```bitbake
#@TYPE: Machine
#@NAME: Ka-Ro electronics TX6U-8130
#@SOC: i.MX6DL
#@DESCRIPTION: Machine configuration for Ka-Ro electronics TX6U-8033 Computer-On-Module
#@MAINTAINER: Ka-Ro electronics GmbH <support@karo-electronics.com>

require include/imx6dl-tx6-nand.inc
require include/imx6qdl-tx6-lvds.inc

KERNEL_DEVICETREE ?= "imx6dl-tx6u-811x.dtb \
		      imx6dl-tx6u-81xx-mb7.dtb \
"

UBOOT_CONFIG[generic] = "tx6u-81x0_config"
UBOOT_CONFIG[mfg] = "tx6u-81x0_mfg_config"
UBOOT_CONFIG[noenv] = "tx6u-81x0_noenv_config"
UBOOT_CONFIG[secure-boot] = "tx6u-81x0_sec_config"

MACHINEOVERRIDES =. "tx6u-8130:"
```

## conf/machine/tx6u-8133.conf
```bitbake
#@TYPE: Machine
#@NAME: Ka-Ro electronics TX6U-8133
#@SOC: i.MX6DL
#@DESCRIPTION: Machine configuration for Ka-Ro electronics TX6U-8133 Computer-On-Module
#@MAINTAINER: Ka-Ro electronics GmbH <support@karo-electronics.com>

require include/imx6dl-tx6-emmc.inc
require include/imx6qdl-tx6-lvds.inc

KERNEL_DEVICETREE ?= "imx6dl-tx6u-8133.dtb \
		      imx6dl-tx6u-8133-mb7.dtb \
"

UBOOT_CONFIG[generic] = "tx6u-8133_config"
UBOOT_CONFIG[mfg] = "tx6u-8133_mfg_config"
UBOOT_CONFIG[noenv] = "tx6u-8133_noenv_config"
UBOOT_CONFIG[secure-boot] = "tx6u-8133_sec_config"

MACHINEOVERRIDES =. "tx6u-8133:"
```

## conf/machine/tx8m-1610.conf
```bitbake
#@TYPE: Machine
#@NAME: Ka-Ro electronics NXP i.MX8MM TX8M-1610 Computer-On-Module
#@SOC: i.MX8MM
#@DESCRIPTION: Machine configuration for Ka-Ro electronics TX8M-1610 Computer-On-Module
#@MAINTAINER: Ka-Ro electronics GmbH <support@karo-electronics.com>

require include/tx8-base.inc

MACHINEOVERRIDES_append = "tx8m:mx8mm:tx8m-1610:"

# u-boot configs
UBOOT_CONFIG[generic] = "tx8m-1610_config"
UBOOT_CONFIG[noenv] = "tx8m-1610_noenv_config"
UBOOT_CONFIG[mfg] = "tx8m-1610_mfg_config"
UBOOT_CONFIG[secure-boot] = "tx8m-1610_sec_config"

IMX_BOOT_SEEK = "33"

# Set U-Boot DTB
UBOOT_DTB_NAME = "imx8mm-tx8m-1610.dtb"

# Ka-Ro specific Device Tree files to be compiled
KERNEL_DEVICETREE = " \
                    freescale/imx8mm-tx8m-1610.dtb \
                    freescale/imx8mm-tx8m-1610-mipi-mb.dtb \
"
#freescale/imx8mm-tx8m-1610-mb7.dtb 
```
