## conf/machine/tx8m-1620.conf
```bitbake
#@TYPE: Machine
#@NAME: Ka-Ro electronics NXP i.MX8MM TX8M-1620 Computer-On-Module
#@SOC: i.MX8MM
#@DESCRIPTION: Machine configuration for Ka-Ro electronics TX8M-1620 Computer-On-Module
#@MAINTAINER: Ka-Ro electronics GmbH <support@karo-electronics.com>

require include/tx8-base.inc

MACHINEOVERRIDES_append = "tx8m:mx8mm:tx8m-1620:"

# u-boot configs
UBOOT_CONFIG[generic] = "tx8m-1620_config"
UBOOT_CONFIG[noenv] = "tx8m-1620_noenv_config"
UBOOT_CONFIG[mfg] = "tx8m-1620_mfg_config"
UBOOT_CONFIG[secure-boot] = "tx8m-1620_sec_config"

IMX_BOOT_SEEK = "33"

# Set U-Boot DTB
UBOOT_DTB_NAME = "imx8mm-tx8m-1620.dtb"

# Ka-Ro specific Device Tree files to be compiled
KERNEL_DEVICETREE = " \
		    freescale/imx8mm-tx8m-1620.dtb \
		    freescale/imx8mm-tx8m-1620-lvds-mb.dtb \
"
#freescale/imx8mm-tx8m-1620-mb7.dtb 
```

## conf/machine/tx8m-nd00.conf
```bitbake
#@TYPE: Machine
#@NAME: Ka-Ro electronics NXP i.MX8MN TX8M-ND00 Computer-On-Module
#@SOC: i.MX8MN
#@DESCRIPTION: Machine configuration for Ka-Ro electronics TX8M-ND00 Computer-On-Module
#@MAINTAINER: Ka-Ro electronics GmbH <support@karo-electronics.com>

require include/tx8-base.inc

MACHINEOVERRIDES_append = "tx8m:mx8mn:tx8m-nd00:"

# u-boot configs
UBOOT_CONFIG[generic] = "tx8m-nd00_config"
UBOOT_CONFIG[noenv] = "tx8m-nd00_noenv_config"
UBOOT_CONFIG[mfg] = "tx8m-nd00_mfg_config"
UBOOT_CONFIG[secure-boot] = "tx8m-nd00_sec_config"

IMX_BOOT_SEEK = "32"

# Set U-Boot DTB
UBOOT_DTB_NAME = "imx8mn-tx8m-nd00.dtb"

# Ka-Ro specific Device Tree files to be compiled
KERNEL_DEVICETREE = " \
		    freescale/imx8mn-tx8m-nd00.dtb \
		    freescale/imx8mn-tx8m-nd00-mipi-mb.dtb \
"
#freescale/imx8mn-tx8m-nd00-mb7.dtb 
```

## conf/machine/txrz-g2l1.conf
```bitbake
#@TYPE: Machine
#@NAME: txrz-g2l1
#@DESCRIPTION: Machine Configuration for Ka-Ro electronics GmbH's TXRZ-G2L1 CoM

MACHINEOVERRIDES =. "txrz:"

include include/rzg2-base.inc

# =========================================================================
# U-Boot configs
# =========================================================================
UBOOT_CONFIG[generic] = "txrz-g2l1_defconfig"
UBOOT_CONFIG[noenv] = "txrz-g2l1_noenv_defconfig"

# Kernel
KERNEL_DEVICETREE ?= " \
	renesas/r9a07g044l2-txrz-g2l1.dtb \
"
```

## conf/machine/txul-5010.conf
```bitbake
#@TYPE: Machine
#@NAME: Ka-Ro electronics TXUL-5010
#@SOC: i.MX6UL
#@DESCRIPTION: Machine configuration for Ka-Ro electronics TXUL-5010 Computer-On-Module
#@MAINTAINER: Ka-Ro electronics GmbH <support@karo-electronics.com>

DTB_BASENAME:mx6ul ?= "${@ "imx6ul-txul-5010" if d.getVar('KARO_BASEBOARD') != "" else "imx6ul-tx6ul-0010"}"

require include/imx6ul-txul-nand.inc

KERNEL_DEVICETREE ?= "imx6ul-tx6ul-0010.dtb \
		      imx6ul-txul-5010-mainboard.dtb \
                      imx6ul-txul-5010-mb7.dtb \
"

UBOOT_CONFIG[generic] = "txul-5010_config"
UBOOT_CONFIG[mfg] = "txul-5010_mfg_config"
UBOOT_CONFIG[noenv] = "txul-5010_noenv_config"
UBOOT_CONFIG[secure-boot] = "txul-5010_sec_config"
```

## conf/machine/txul-5011.conf
```bitbake
#@TYPE: Machine
#@NAME: Ka-Ro electronics TXUL-5011
#@SOC: i.MX6UL
#@DESCRIPTION: Machine configuration for Ka-Ro electronics TXUL-5011 Computer-On-Module
#@MAINTAINER: Ka-Ro electronics GmbH <support@karo-electronics.com>

DTB_BASENAME_mx6ul ?= "${@ "imx6ul-txul-5011" if d.getVar('KARO_BASEBOARD') != "" else "imx6ul-tx6ul-0011"}"

require include/imx6ul-txul-emmc.inc

KERNEL_DEVICETREE ?= " \
		     imx6ul-tx6ul-0011.dtb \
		     imx6ul-txul-5011-mainboard.dtb \
		     imx6ul-txul-5011-mb7.dtb \
"

UBOOT_CONFIG[generic] = "txul-5011_config"
UBOOT_CONFIG[mfg] = "txul-5011_mfg_config"
UBOOT_CONFIG[noenv] = "txul-5011_noenv_config"
UBOOT_CONFIG[secure-boot] = "txul-5011_sec_config"
```

## conf/machine/txul-8013.conf
```bitbake
#@TYPE: Machine
#@NAME: Ka-Ro electronics TXUL-8013
#@SOC: i.MX6ULL
#@DESCRIPTION: Machine configuration for Ka-Ro electronics TXUL-8013 Computer-On-Module
#@MAINTAINER: Ka-Ro electronics GmbH <support@karo-electronics.com>

require include/imx6ull-txul-emmc.inc

KERNEL_DEVICETREE ?= " \
		     imx6ull-txul-8013.dtb \
		     imx6ull-txul-8013-mb7.dtb \
		     imx6ull-txul-8013-mainboard.dtb \
"

UBOOT_CONFIG[generic] = "tx6ul-8013_config"
UBOOT_CONFIG[mfg] = "tx6ul-8013_mfg_config"
UBOOT_CONFIG[noenv] = "tx6ul-8013_noenv_config"
UBOOT_CONFIG[secure-boot] = "tx6ul-8013_sec_config"

MACHINEOVERRIDES =. "txul-8013:"
```
