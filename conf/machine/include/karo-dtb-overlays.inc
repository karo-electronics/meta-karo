## conf/machine/qsmp-1530.conf
```bitbake
#@TYPE: Machine
#@NAME: qsmp-1530
#@DESCRIPTION: Machine Configuration for Ka-Ro electronics GmbH's QSMP-1530 CoM

MACHINEOVERRIDES =. "stm32mp15:qsmp:"

require include/stm32mp1-base.inc
require include/stm32mp15-overlays.inc

SOC_PREFIX = "stm32mp15"
SOC_FAMILY = "stm32mp153a"

# =========================================================================
# U-Boot configs
# =========================================================================
UBOOT_CONFIG[optee] = "qsmp-1530_optee_defconfig"
UBOOT_CONFIG[trusted] = "qsmp-1530_trusted_defconfig"
UBOOT_CONFIG[noenv]   = "qsmp-1530_noenv_defconfig"
UBOOT_CONFIG[mfg] = "qsmp-1530_mfg_defconfig"

# op-tee
BOARD_DRAM_SIZE = "0x10000000"
```

## conf/machine/qsmp-1570.conf
```bitbake
#@TYPE: Machine
#@NAME: qsmp-1570
#@DESCRIPTION: Machine Configuration for Ka-Ro electronics GmbH's QSMP-1570 CoM

MACHINEOVERRIDES =. "stm32mp15:qsmp:"

require include/stm32mp1-base.inc
require include/stm32mp15-overlays.inc

SOC_PREFIX = "stm32mp15"
SOC_FAMILY = "stm32mp157c"

# =========================================================================
# U-Boot configs
# =========================================================================
UBOOT_CONFIG[optee] = "qsmp-1570_optee_defconfig"
UBOOT_CONFIG[trusted] = "qsmp-1570_trusted_defconfig"
UBOOT_CONFIG[noenv]   = "qsmp-1570_noenv_defconfig"
UBOOT_CONFIG[mfg] = "qsmp-1570_mfg_defconfig"
```

## conf/machine/qsmp-2030.conf
```bitbake
#@TYPE: Machine
#@NAME: qsmp-2030
#@DESCRIPTION: Machine Configuration for Ka-Ro electronics GmbH's QSMP-2030 CoM

MACHINEOVERRIDES =. "stm32mp23common:stm32mp23:qsmp:qsmp20:"

#MACHINE_FEATURES:append = " lvds"

require include/stm32mp2-base.inc
require include/stm32mp23-overlays.inc

SOC_PREFIX = "stm32mp23"
SOC_FAMILY = "stm32mp235c"

KARO_BOARD_PMIC ?= "pca9450"

# =========================================================================
# U-Boot configs
# =========================================================================
UBOOT_CONFIG[optee] = "qsmp-2030_optee_defconfig"
UBOOT_CONFIG[trusted] = "qsmp-2030_trusted_defconfig"
UBOOT_CONFIG[noenv] = "qsmp-2030_noenv_defconfig"
UBOOT_CONFIG[mfg] = "qsmp-2030_mfg_defconfig"

SERIAL_CONSOLES ?= "115200;ttySTM0 \
                115200;ttySTM2 \
"

NETWORK_INTERFACES ?= "eth0 \
        ${@ "eth1" if d.getVar('KARO_BASEBOARD') == "qsbase5" else ""} \
"

TF_A_DDR_TARGET ?= "ddr3"
```

## conf/machine/qsmp-2350.conf
```bitbake
#@TYPE: Machine
#@NAME: qsmp-2350
#@DESCRIPTION: Machine Configuration for Ka-Ro electronics GmbH's QSMP-2350 CoM

MACHINEOVERRIDES =. "stm32mp23common:stm32mp23:qsmp:"

MACHINE_FEATURES:append = " lvds"

require include/stm32mp2-base.inc
require include/stm32mp23-overlays.inc

SOC_PREFIX = "stm32mp23"
SOC_FAMILY = "stm32mp235c"

KARO_BOARD_PMIC ?= "pca9450"

# =========================================================================
# U-Boot configs
# =========================================================================
UBOOT_CONFIG[optee] = "qsmp-2350_optee_defconfig"
UBOOT_CONFIG[trusted] = "qsmp-2350_trusted_defconfig"
UBOOT_CONFIG[noenv] = "qsmp-2350_noenv_defconfig"
UBOOT_CONFIG[mfg] = "qsmp-2350_mfg_defconfig"

SERIAL_CONSOLES ?= "115200;ttySTM0 \
        ${@ "115200;ttySTM1" if d.getVar('KARO_BASEBOARD') != "qsbase5" else ""} \
        115200;ttySTM2 \
"

NETWORK_INTERFACES ?= "eth0 \
        ${@ "eth1" if d.getVar('KARO_BASEBOARD') == "qsbase5" else ""} \
"
```

## conf/machine/qsmp-2550.conf
```bitbake
#@TYPE: Machine
#@NAME: qsmp-2550
#@DESCRIPTION: Machine Configuration for Ka-Ro electronics GmbH's QSMP-2550 CoM

MACHINEOVERRIDES =. "qsmp:"

MACHINE_FEATURES:append = " lvds"

require include/stm32mp2-base.inc

SOC_PREFIX = "stm32mp25"
SOC_FAMILY = "stm32mp255f"

KARO_BOARD_PMIC ?= "pca9450"

# =========================================================================
# U-Boot configs
# =========================================================================
UBOOT_CONFIG[optee] = "qsmp-2550_optee_defconfig"
UBOOT_CONFIG[trusted] = "qsmp-2550_trusted_defconfig"
UBOOT_CONFIG[noenv] = "qsmp-2550_noenv_defconfig"
UBOOT_CONFIG[mfg] = "qsmp-2550_mfg_defconfig"

BOOTDEVICE_LABELS ?= "emmc"

# Trusted Firmware
TF_A_DEVICETREE ?= "stm32mp255f-qsmp-2550"

SERIAL_CONSOLES ?= "115200;ttySTM0 \
        ${@ "115200;ttySTM1" if d.getVar('KARO_BASEBOARD') != "qsbase5" else ""} \
        115200;ttySTM2 \
"
NETWORK_INTERFACES ?= "eth0 \
        ${@ "eth1" if d.getVar('KARO_BASEBOARD') == "qsbase5" else ""} \
"

# Kernel
KERNEL_DEVICETREE ?= "st/stm32mp255f-qsmp-2550.dtb"
```

## conf/machine/txmp-1530.conf
```bitbake
#@TYPE: Machine
#@NAME: txmp-1530
#@DESCRIPTION: Machine Configuration for Ka-Ro electronics GmbH's TXMP-1530 CoM

MACHINEOVERRIDES =. "stm32mp15:txmp:"

require include/stm32mp1-base.inc
require include/stm32mp15-overlays.inc

SOC_PREFIX = "stm32mp15"
SOC_FAMILY = "stm32mp153a"

# =========================================================================
# U-Boot configs
# =========================================================================
UBOOT_CONFIG[optee] = "txmp-1530_optee_defconfig"
UBOOT_CONFIG[trusted] = "txmp-1530_trusted_defconfig"
UBOOT_CONFIG[noenv]   = "txmp-1530_noenv_defconfig"
UBOOT_CONFIG[mfg] = "txmp-1530_mfg_defconfig"
```

## conf/machine/txmp-1570.conf
```bitbake
#@TYPE: Machine
#@NAME: txmp-1570
#@DESCRIPTION: Machine Configuration for Ka-Ro electronics GmbH's TXMP-1570 CoM

MACHINEOVERRIDES =. "stm32mp15:txmp:"

require include/stm32mp1-base.inc
require include/stm32mp15-overlays.inc

SOC_PREFIX = "stm32mp15"
SOC_FAMILY = "stm32mp157c"

# =========================================================================
# U-Boot configs
# =========================================================================
UBOOT_CONFIG[optee] = "txmp-1570_optee_defconfig"
UBOOT_CONFIG[trusted] = "txmp-1570_trusted_defconfig"
UBOOT_CONFIG[noenv]   = "txmp-1570_noenv_defconfig"
UBOOT_CONFIG[mfg] = "txmp-1570_mfg_defconfig"
```

## conf/machine/txmp-1571.conf
```bitbake
#@TYPE: Machine
#@NAME: txmp-1571
#@DESCRIPTION: Machine Configuration for Ka-Ro electronics GmbH's TXMP-1571 CoM

MACHINEOVERRIDES =. "stm32mp15:txmp:"

require include/stm32mp1-base.inc
require include/stm32mp15-overlays.inc

SOC_PREFIX = "stm32mp15"
SOC_FAMILY = "stm32mp157c"

# =========================================================================
# U-Boot configs
# =========================================================================
UBOOT_CONFIG[optee] = "txmp-1571_optee_defconfig"
UBOOT_CONFIG[trusted] = "txmp-1571_trusted_defconfig"
UBOOT_CONFIG[noenv]   = "txmp-1571_noenv_defconfig"
UBOOT_CONFIG[mfg] = "txmp-1571_mfg_defconfig"
```

## conf/machine/txmp-2550.conf
```bitbake
#@TYPE: Machine
#@NAME: txmp-2550
#@DESCRIPTION: Machine Configuration for Ka-Ro electronics GmbH's TXMP-2550 CoM

MACHINEOVERRIDES =. "stm32mp25common:stm32mp25:txmp:"

require include/stm32mp2-base.inc
require include/stm32mp25-overlays.inc

SOC_PREFIX = "stm32mp25"
SOC_FAMILY = "stm32mp257f"

# =========================================================================
# U-Boot configs
# =========================================================================
UBOOT_CONFIG[optee] = "txmp-2550_optee_defconfig"
UBOOT_CONFIG[trusted] = "txmp-2550_trusted_defconfig"
UBOOT_CONFIG[noenv] = "txmp-2550_noenv_defconfig"
UBOOT_CONFIG[mfg] = "txmp-2550_mfg_defconfig"
```

## conf/machine/txmp-2570.conf
```bitbake
#@TYPE: Machine
#@NAME: txmp-2570
#@DESCRIPTION: Machine Configuration for Ka-Ro electronics GmbH's TXMP-2570 CoM

MACHINEOVERRIDES =. "stm32mp25common:stm32mp25:txmp:"

require include/stm32mp2-base.inc
require include/stm32mp25-overlays.inc

SOC_PREFIX = "stm32mp25"
SOC_FAMILY = "stm32mp257f"

MACHINE_FEATURES:append = " stm-tsn-swch"

# =========================================================================
# U-Boot configs
# =========================================================================
UBOOT_CONFIG[optee] = "txmp-2570_optee_defconfig"
UBOOT_CONFIG[trusted] = "txmp-2570_trusted_defconfig"
UBOOT_CONFIG[noenv] = "txmp-2570_noenv_defconfig"
UBOOT_CONFIG[mfg] = "txmp-2570_mfg_defconfig"
```
