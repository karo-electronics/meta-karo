## conf/machine/include/karo.inc
```bitbake
KBUILD_BUILD_USER := "support"
KBUILD_BUILD_HOST := "karo-electronics.de"

# build u-boot with image
EXTRA_IMAGEDEPENDS += "u-boot-karo"
PREFERRED_PROVIDER_u-boot ??= "u-boot-karo"
PREFERRED_PROVIDER_virtual/bootloader ??= "u-boot-karo"

BUILD_REPRODUCIBLE_BINARIES ?= "0"
INHERIT:remove = "${@'reproducible_build' if d.getVar('BUILD_REPRODUCIBLE_BINARIES') == '0' else ''}"

PREFERRED_PROVIDER_virtual/kernel ??= "linux-karo"
PREFERRED_VERSION_linux-karo = "6.1"

MACHINEOVERRIDES =. "use-mainline-bsp:"

IMAGE_CLASSES += "st-partitions-image"

FIPTOOL_DIR = "fiptool"

GPU_IMAGE_INSTALL ??= ""
GPU_LIST ??= ""

GPU_USERLAND_LIBRARIES_INSTALL ??= "libdrm-etnaviv"

GPU_LIST:stm32mp2 = "\
    gcnano-driver-stm32mp \
    ${GPU_USERLAND_LIBRARIES_INSTALL} \
"

GPU_IMAGE_INSTALL:stm32mp2 = "${@bb.utils.contains('MACHINE_FEATURES', 'gpu', '${GPU_LIST}', '', d)} "

# Ship kernel modules
MACHINE_EXTRA_RRECOMMENDS = " \
    kernel-modules \
    kernel-devicetree \
    u-boot-karo \
    ${GPU_IMAGE_INSTALL} \
"

MACHINE_FEATURES = " \
                 alsa \
                 rtc \
                 serial \
                 usbgadget \
                 usbhost \
                 vfat \
"

UBOOT_FEATURES ??= ""
KARO_BASEBOARD ??= ""

# Blacklist evbug kernel module
KERNEL_MODULE_PROBECONF += "evbug"
module_conf_evbug = "blacklist evbug"
```

## conf/machine/include/r9a07g044l2-base.inc
```bitbake
MACHINEOVERRIDES =. "r9a07g044l:rzg2:rzg2l:"

DEFAULTTUNE ?= "cortexa55"

require karo-base.inc
require conf/machine/include/arm/armv8-2a/tune-cortexa55.inc

SOC_PREFIX = "r9a07g044l2"
SOC_FAMILY ??= "${SOC_PREFIX}"

# build u-boot with image
EXTRA_IMAGEDEPENDS += "flashwriter-rzg2"

KERNEL_IMAGETYPE ?= "Image"

MACHINE_FEATURES:append = " emmc"
MACHINE_FEATURES:append:qsrz = " dsi83"
MACHINE_FEATURES:append:qsrz = " lvds"

UBOOT_CONFIG ??= "generic noenv"

DTB_VENDOR_DIR = "renesas"

PREFERRED_VERSION_u-boot-karo = "2020.10"
PREFERRED_VERSION_linux-karo = "6.1"

# Kernel
KERNEL_DEVICETREE ?= "renesas/${DTB_BASENAME}.dtb"

# Set Serial consoles
SERIAL_CONSOLES ?= "115200;ttySC0 115200;ttySC1 ${@ bb.utils.contains('DISTRO_FEATURES', 'copro', "", "115200;ttySC2", d)}"
SERIAL_CONSOLES:txrz ?= "115200;ttySC0 115200;ttySC1"
```

## conf/machine/include/stm32mp1-base.inc
```bitbake
MACHINEOVERRIDES =. "stm32mpcommon:stm32mp1common:stm32mp1:"

DEFAULTTUNE ?= "cortexa7thf-neon-vfpv4"

require karo-base.inc
require conf/machine/include/soc-family.inc
require conf/machine/include/arm/armv7a/tune-cortexa7.inc

MACHINE_FEATURES:append = " emmc"
MACHINE_FEATURES:append = " optee"

UBOOT_CONFIG ??= "${@ "optee" if 'optee' in d.getVar('MACHINE_FEATURES').split() else "trusted"} mfg noenv"

UBOOT_ENTRYPOINT = "0xc0008000"

DTB_OVERLAY_EXT = "dtb"
DTB_VENDOR_DIR = "st"

KERNEL_IMAGETYPE ?= "uImage"

PREFERRED_VERSION_u-boot-karo = "2022.10"
PREFERRED_VERSION_linux-karo = "6.6"

# Kernel
KERNEL_DEVICETREE ?= "st/${DTB_BASENAME}.dtb"

# Set Serial consoles
SERIAL_CONSOLES ?= "115200;ttySTM0 115200;ttySTM1 115200;ttySTM2"

# =========================================================================
# boot scheme
# =========================================================================
# List of supported boot schemes
BOOTSCHEME_LABELS ??= "optee"
BOOTSCHEME_DEFAULT ??= "optee"

INITIAL_BOOTSCHEME[tf-a] = "usb"
INITIAL_BOOTSCHEME[fip] = "mfg"

BOOTLOADER_BINARIES = "tf-a.stm32 fip.bin"

# =========================================================================
# tf-a
# =========================================================================
# Finally we must compile tf-a in all cases as we need trusted binary to boot
EXTRA_IMAGEDEPENDS += "tf-a-karo"
EXTRA_IMAGEDEPENDS += "optee-os"

# Set default TF-A config
TF_A_CONFIG = "usb"
TF_A_CONFIG:prepend = "${@bb.utils.contains('BOOTSCHEME_LABELS', 'trusted', 'trusted ', '', d)}"
TF_A_CONFIG:prepend = "${@bb.utils.contains('BOOTSCHEME_LABELS', 'optee', 'optee ', '', d)}"

# link TF_A_CONFIG to UBOOT_CONFIG
TF_A_CONFIG[mfg] = "usb"
TF_A_CONFIG[noenv] = "${@bb.utils.contains('BOOTSCHEME_LABELS', 'optee', "optee", "trusted", d)}"

TF_A_TOOLS_PLATFORM ?= "stm32mp1"
TF_A_DEVICETREE ?= "${SOC_FAMILY}-${MACHINE}"

# coprocessor stuff
M4_BOARDS ?= "STM32MP157C-DK2"

# op-tee
OPTEE_CONF ?= "${DTB_BASENAME}"
STM32MP_SOC_NAME ?= "${SOC_PREFIX}"

BOARD_DRAM_SIZE ??= "0x20000000"
```

## conf/machine/include/stm32mp15-overlays.inc
```bitbake
require karo-dtb-overlays.inc

# DTB overlays
DTB_OVERLAYS ??= ""

DTB_OVERLAY_INCLUDES ?= "\
        karo-ft5x06 \
        karo-lcd-panel \
        karo-sound \
"

# STM32
DTB_OVERLAYS_generic:append:stm32mp1 = " \
        ${@ mach_overlay(d, "karo-copro", dist="copro")} \
        ${@ mach_overlay(d, "karo-gpu", "stm32mp157c")} \
        karo-rtc \
"
DTB_OVERLAYS_generic:append:txmp = " \
        txmp-ft5x06 \
        txmp-lcd-panel \
        txmp-sdcard \
        txmp-sdcard-cd \
        txmp-sound \
        txmp-spidev \
"
DTB_OVERLAYS_generic:append:qsmp = " \
        ${@ mach_overlay(d, "qsmp-dsi-panel", "stm32mp157c")} \
        qsmp-ft5x06 \
        qsmp-ksz9031 \
        qsmp-ksz9131 \
        qsmp-lcd-panel \
        qsmp-qsbase1 \
        qsmp-qsbase2 \
        qsmp-qsbase4 \
        qsmp-qsglyn1 \
        ${@ mach_overlay(d, "qsmp-raspi-display", "stm32mp157c")} \
        qsmp-sdcard \
        qsmp-sdcard-cd \
        qsmp-smsc-phy \
        qsmp-sound \
        qsmp-spidev1 \
        qsmp-spidev2 \
"
DTB_OVERLAYS_generic:append:qsmp-1570w = " \
        qsmp-bcm4373 \
"
DTB_OVERLAYS_generic:append:qsmp-1530w = " \
        qsmp-bcm4373 \
"

KARO_BASEBOARDS:txmp ?= "\
        mb7 \
"

KARO_BASEBOARDS:qsmp ?= "\
        qsbase1 \
        qsbase2 \
        qsbase4 \
"

KARO_BASEBOARDS:append:qsmp-1570 ?= "\
        qsglyn1 \
"

KARO_BASEBOARDS:qsmp-1510 ?= "\
        qsbase1 \
        qsbase4 \
"

# baseboard DTB specific overlays
KARO_DTB_OVERLAYS[mb7] = " \
        ${@ mach_overlay(d, "karo-copro", dist="copro")} \
        txmp-ft5x06 \
        ${@ mach_overlay(d, "karo-gpu", "stm32mp157c", "wayland")} \
        txmp-lcd-panel \
        karo-rtc \
        txmp-sdcard \
        txmp-sdcard-cd \
        txmp-sound \
        txmp-spidev \
"

KARO_DTB_OVERLAYS[qsbase1] = " \
        ${@ mach_overlay(d, "qsmp-bcm4373", dist="bcm4373")} \
        ${@ mach_overlay(d, "karo-copro", dist="copro")} \
        ${@ mach_overlay(d, "karo-gpu", "stm32mp157c", "wayland")} \
        qsmp-ksz9031 \
        qsmp-lcd-panel \
        qsmp-qsbase1 \
        qsmp-sdcard \
        qsmp-spidev1 \
        qsmp-spidev2 \
"

KARO_DTB_OVERLAYS[qsbase2] = " \
        ${@ mach_overlay(d, "karo-copro", dist="copro")} \
        ${@ mach_overlay(d, "qsmp-dsi-panel", "stm32mp157c")} \
        qsmp-ksz9031 \
        qsmp-qsbase2 \
        ${@ mach_overlay(d, "qsmp-raspi-display", "stm32mp157c")} \
        qsmp-spidev2 \
"

KARO_DTB_OVERLAYS[qsbase4] = " \
        ${@ mach_overlay(d, "karo-copro", dist="copro")} \
        ${@ mach_overlay(d, "qsmp-dsi-panel", "stm32mp157c")} \
        ${@ mach_overlay(d, "karo-gpu", "stm32mp157c", "wayland")} \
        qsmp-ksz9131 \
        qsmp-qsbase4 \
        ${@ mach_overlay(d, "qsmp-raspi-display", "stm32mp157c")} \
        qsmp-spidev1 \
        qsmp-spidev2 \
"

KARO_DTB_OVERLAYS[qsglyn1] = " \
        ${@ mach_overlay(d, "karo-copro", dist="copro")} \
        ${@ mach_overlay(d, "karo-gpu", "stm32mp157c", "wayland")} \
        qsmp-ksz9031 \
        qsmp-lcd-panel \
        qsmp-qsglyn1 \
"
```

## conf/machine/include/stm32mp2-base.inc
```bitbake
MACHINEOVERRIDES =. "stcommon:stm32mpcommon:stm32mp2common:stm32mp25common:stm32mp2:stm32mp25:"

DEFAULTTUNE ?= "cortexa35"

require karo.inc
require conf/machine/include/soc-family.inc
require conf/machine/include/arm/armv8a/tune-cortexa35.inc

MACHINE_FEATURES:append = " emmc"
MACHINE_FEATURES:append = " optee"
MACHINE_FEATURES:append = " gpu"

UBOOT_CONFIG ??= "${@ "optee" if 'optee' in d.getVar('MACHINE_FEATURES').split() else "trusted"} mfg noenv"
UBOOT_FEATURES ?= "${@ "emmc fastboot" if 'emmc' in d.getVar('MACHINE_FEATURES').split() else ""}"

UBOOT_ENTRYPOINT = "0xc4000000"

KERNEL_IMAGETYPE ?= "Image"

# Set Serial consoles
SERIAL_CONSOLES ?= "115200;ttySTM0 ${@ " 115200;ttySTM1" if d.getVar('KARO_BASEBOARD') != "qsbase5" else ""} 115200;ttySTM2"

# =========================================================================
# boot scheme
# =========================================================================
# List of supported boot schemes
BOOTSCHEME_LABELS ??= "optee"
BOOTDEVICE_LABELS ?= "emmc sdcard"

# =========================================================================
# tf-a
# =========================================================================
# Finally we must compile tf-a in all cases as we need trusted binary to boot
EXTRA_IMAGEDEPENDS += "tf-a-karo"
EXTRA_IMAGEDEPENDS += "optee-os"

# Define default TF-A config
# Set default TF-A config
TF_A_CONFIG = "usb"
TF_A_CONFIG:prepend = "${@bb.utils.contains('BOOTSCHEME_LABELS', 'trusted', 'trusted ', '', d)}"
TF_A_CONFIG:prepend = "${@bb.utils.contains('BOOTSCHEME_LABELS', 'optee', 'optee ', '', d)}"

TF_A_TOOLS_PLATFORM ?= "stm32mp2"

# link TF_A_CONFIG to UBOOT_CONFIG
TF_A_CONFIG[mfg] = "usb"
TF_A_CONFIG[noenv] = "${@bb.utils.contains('BOOTSCHEME_LABELS', 'optee', "optee", "trusted", d)}"

# Manage proper update for TF_A_CONFIG_* var
tfaconfig_env[vardeps] += "${@bb.utils.contains('TF_A_CONFIG', 'usb', 'TF_A_CONFIG_usb', '', d)}"
tfaconfig_env[vardeps] += "${@bb.utils.contains('TF_A_CONFIG', 'trusted', 'TF_A_CONFIG_trusted', '', d)}"
tfaconfig_env[vardeps] += "${@bb.utils.contains('TF_A_CONFIG', 'optee', 'TF_A_CONFIG_optee', '', d)}"

DTB_BASENAME ?= "${SOC_FAMILY}-${MACHINE}"
KARO_BOARD_PMIC ??= "stpmic2"

# op-tee
OPTEE_CONF ?= "${DTB_BASENAME}"
STM32MP_SOC_NAME ?= "${SOC_PREFIX}"

BOARD_DRAM_SIZE ??= "0x20000000"

FIP_CONFIG += "${@bb.utils.contains('BOOTSCHEME_LABELS', 'optee', 'optee', '', d)}"

# Define config for each FIP_CONFIG
FIP_CONFIG[optee]   ?= "optee,${FIP_DEVICETREE_OPTEE}"

# List of device tree to use for fip binary creation
FIP_DEVICETREE_OPTEE   ?= "${STM32MP_DEVICETREE}"

# Define fiptool wrapper name
FIPTOOL_WRAPPER ?= "fiptool-stm32mp"

# Manage specific config to sign FIP
FIP_SIGN_SUFFIX ?= "${@bb.utils.contains('SIGN_ENABLE', '1', '${SIGN_SUFFIX}', '', d)}"
FIP_ENCRYPT_SUFFIX ?= "${@bb.utils.contains('ENCRYPT_ENABLE', '1', '${ENCRYPT_SUFFIX}', '', d)}"

# Configure use of BL31
FIP_BL31_ENABLE = "0"
FIP_BL31_ENABLE:stm32mp25common = "1"

REGULATORS_MICROVOLTS = "1"
```

## conf/machine/include/stm32mp23-overlays.inc
```bitbake
require karo-dtb-overlays.inc

# DTB overlays
DTB_OVERLAYS ??= ""
DTB_OVERLAY_INCLUDES ??= ""
DTB_OVERLAYS_generic ??= ""
KARO_DTB_OVERLAYS ??= ""

DTB_OVERLAY_INCLUDES ?= "\
        karo-lcd-panel \
        karo-sound \
"

DTB_OVERLAYS_generic:append = " \
        karo-gpu \
        karo-rtc \
        ${@ mach_overlay(d, "karo-copro", dist="copro")} \
"

DTB_OVERLAYS_generic:append:qsmp = " \
        karo-panel-tm101jvhg32 \
        qsmp-csi \
        qsmp-dsi-panel \
        qsmp-eth1-ksz9031 \
        ${@ mach_overlay(d, "qsmp-2030-eth1-ksz9131:qsmp-eth1-ksz9131", mach="qsmp20")} \
        qsmp-eth1-lan8710 \
        qsmp-eth2-lan8710 \
        qsmp-fdcan1 \
        qsmp-lcd-panel \
        qsmp-lvds-panel \
        qsmp-qsbase5 \
        qsmp-raspi-display \
        qsmp-sdcard \
        qsmp-sdcard-cd \
        qsmp-spidev1 \
"

KARO_BASEBOARDS:qsmp ?= "\
        qsbase1 \
        qsbase4 \
        qsbase5 \
"

KARO_DTB_OVERLAYS[qsbase1] = " \
        ${@ mach_overlay(d, "karo-copro", dist="copro")} \
        ${@ mach_overlay(d, "karo-gpu", dist="wayland")} \
        qsmp-lcd-panel \
        qsmp-eth1-ksz9031 \
        qsmp-fdcan1 \
        qsmp-sdcard \
"

KARO_DTB_OVERLAYS[qsbase4] = " \
        ${@ mach_overlay(d, "karo-copro", dist="copro")} \
        ${@ mach_overlay(d, "karo-gpu", dist="wayland")} \
        ${@ mach_overlay(d, "qsmp-dsi-panel", mach="qsmp20")} \
        ${@ mach_overlay(d, "qsmp-2030-eth1-ksz9131:qsmp-eth1-ksz9131", mach="qsmp20")} \
        qsmp-fdcan1 \
        ${@ mach_overlay(d, "qsmp-raspi-display", mach="qsmp20")} \
"

KARO_DTB_OVERLAYS[qsbase5] = " \
        ${@ mach_overlay(d, "karo-copro", dist="copro")} \
        ${@ mach_overlay(d, "karo-gpu", dist="wayland")} \
        qsmp-csi \
        qsmp-eth1-lan8710 \
        qsmp-eth2-lan8710 \
        qsmp-fdcan1 \
        qsmp-qsbase5 \
        qsmp-lvds-panel \
        qsmp-spidev1 \
        karo-panel-tm101jvhg32 \
"
```

## conf/machine/include/stm32mp25-overlays.inc
```bitbake
require karo-dtb-overlays.inc

# DTB overlays
DTB_OVERLAYS ??= ""
DTB_OVERLAY_INCLUDES ??= ""
DTB_OVERLAYS_generic ??= ""
KARO_DTB_OVERLAYS ??= ""

DTB_OVERLAY_INCLUDES ?= "\
        karo-ft5x06 \
        karo-lcd-panel \
        karo-sound \
"

DTB_OVERLAYS_generic:append = " \
        karo-gpu \
        karo-rtc \
        ${@ mach_overlay(d, "karo-copro", dist="copro")} \
"

DTB_OVERLAYS_generic:append:txmp = " \
        txmp-fdcan1 \
        txmp-fdcan2 \
        txmp-ft5x06 \
        txmp-keypad \
        txmp-lcd-panel \
        txmp-mb7 \
        txmp-mb7-wakeup-btn \
        txmp-sdcard1-cd \
        txmp-sdcard2-cd \
        txmp-sound \
        txmp-spidev \
"

DTB_OVERLAYS_generic:append:qsmp = " \
        karo-panel-tm101jvhg32 \
        qsmp-csi \
        qsmp-eth1-ksz9131 \
        qsmp-eth1-lan8710 \
        qsmp-eth2-lan8710 \
        qsmp-fdcan1 \
        qsmp-fdcan2 \
        qsmp-lvds-panel \
        qsmp-pcie \
        qsmp-qsbase5 \
        qsmp-spidev1 \
        qsmp-spidev2 \
"

KARO_BASEBOARDS:txmp ?= "\
        mb7 \
"

KARO_BASEBOARDS:qsmp ?= "\
        qsbase4 \
        qsbase5 \
"

# baseboard DTB specific overlays
KARO_DTB_OVERLAYS[mb7] = " \
        ${@ mach_overlay(d, "karo-copro", dist="copro")} \
        ${@ mach_overlay(d, "karo-gpu", dist="wayland")} \
        txmp-mb7 \
        txmp-fdcan1 \
        txmp-ft5x06 \
        txmp-keypad,txmp-mb7-wakeup-btn \
        txmp-lcd-panel \
        txmp-sound \
        txmp-spidev \
"

KARO_DTB_OVERLAYS[qsbase4] = " \
        ${@ mach_overlay(d, "karo-copro", dist="copro")} \
        ${@ mach_overlay(d, "karo-gpu", dist="wayland")} \
        qsmp-eth1-ksz9131 \
        qsmp-fdcan1 \
        qsmp-fdcan2 \
        qsmp-spidev2 \
"

KARO_DTB_OVERLAYS[qsbase5] = " \
        ${@ mach_overlay(d, "karo-copro", dist="copro")} \
        ${@ mach_overlay(d, "karo-gpu", dist="wayland")} \
        qsmp-csi \
        qsmp-eth1-lan8710 \
        qsmp-eth2-lan8710 \
        qsmp-fdcan1 \
        qsmp-fdcan2 \
        qsmp-qsbase5 \
        qsmp-lvds-panel \
        qsmp-pcie \
        qsmp-spidev1 \
        qsmp-spidev2 \
        karo-panel-tm101jvhg32 \
"
```

## conf/machine/qsmp-1351.conf
```bitbake
#@TYPE: Machine
#@NAME: qsmp-1351
#@DESCRIPTION: Machine Configuration for Ka-Ro electronics GmbH's QSMP-1351 CoM

MACHINEOVERRIDES =. "stm32mp13:qsmp:"

require include/stm32mp1-base.inc
require include/stm32mp13-overlays.inc

SOC_PREFIX = "stm32mp13"
SOC_FAMILY = "stm32mp135c"

# =========================================================================
# U-Boot configs
# =========================================================================
UBOOT_CONFIG[optee] = "qsmp-1351_optee_defconfig"
UBOOT_CONFIG[noenv] = "qsmp-1351_noenv_defconfig"
UBOOT_CONFIG[mfg] = "qsmp-1351_mfg_defconfig"

# op-tee
BOARD_DRAM_SIZE = "0x10000000"
```
