## base/conf/bblayers.conf
```bitbake
LCONF_VERSION = "6"

BBPATH = "${TOPDIR}"
BSPDIR := "${@os.path.abspath(os.path.dirname(d.getVar('FILE', True)) + '/../..')}"

BBFILES ?= ""
BBLAYERS = " \
  ${BSPDIR}/sources/poky/meta \
  ${BSPDIR}/sources/poky/meta-yocto \
  \
  ${BSPDIR}/sources/meta-karo \
"
```

## base/conf/bblayers.conf.sample
```bitbake
LCONF_VERSION = "7"

BBPATH = "${TOPDIR}"
BSPDIR := "${@os.path.abspath(os.path.dirname(d.getVar('FILE', True)) + '/../..')}"

BBFILES ?= ""
BBLAYERS = " \
  ${BSPDIR}/layers/meta-openembedded/meta-networking \
  ${BSPDIR}/layers/meta-openembedded/meta-oe \
  ${BSPDIR}/layers/meta-openembedded/meta-python \
  \
  ${BSPDIR}/layers/poky/meta \
  ${BSPDIR}/layers/poky/meta-poky \
  ${BSPDIR}/layers/poky/meta-yocto-bsp \
"
```

## conf/distro/include/karo-distro.inc
```bitbake
POKY_DISTRO ??= "poky"
require conf/distro/${POKY_DISTRO}.conf

# DISTRO_FEATURES += " \
#                 alternatives-symlinks-relative \
#                 dhcpcd \
#                 ldconfig \
#                 pam \
#                 telnet-login \
# "

# VIRTUAL-RUNTIME_base-utils-hwclock = "util-linux-hwclock"

WARN_QA_remove = "host-user-contaminated"
```

## conf/distro/include/tcmode-uboot.inc
```bitbake
#
# Default toolchain configuration
#
GCCVERSION = "5.4%"
DEFAULTTUNE_mx6 = "cortexa9-neon"
DEFAULTTUNE_mx6ul = "cortexa7-neon"

include conf/distro/include/tcmode-default.inc
```

## conf/distro/karo-base.conf
```bitbake
require conf/distro/include/karo-distro.inc

DISTRO = "karo-base"

DISTRO_NAME = "karo-base (Ka-Ro TX6 Linux BSP)"
DISTRO_VERISON = "1.0"
DISTRO_CODENAME = "2018-01"

DISTRO_FEATURES_remove = "gobject-introspection-data pulseaudio"
DISTRO_FEATURES_BACKFILL_CONSIDERED += "gobject-introspection-data pulseaudio"

VIRTUAL-RUNTIME_dev_manager ?= "udev"
```

## conf/distro/karo-minimal.conf
```bitbake
require conf/distro/include/karo-distro.inc

DISTRO = "karo-minimal"
DISTRO_NAME = "karo-minimal (Ka-Ro Linux BSP with minimal read-only rootfs)"
DISTRO_VERISON = "1.0"
DISTRO_CODENAME = "2020-03"

DISTRO_FEATURES_remove = "bluetooth bluez5 gobject-introspection-data pulseaudio wayland"
DISTRO_FEATURES_BACKFILL_CONSIDERED += "bluetooth bluez5 gobject-introspection-data pulseaudio"

VIRTUAL-RUNTIME_dev_manager ?= "busybox-mdev"
VIRTUAL-RUNTIME_init_manager ?= "sysvinit"

VOLATILE_LOG_DIR = "no"
```

## conf/distro/karo-wayland.conf
```bitbake
require conf/distro/include/karo-distro.inc

DISTRO = "karo-wayland"
DISTRO_NAME = "karo-wayland (Ka-Ro Linux BSP with wayland backend)"
DISTRO_VERISON = "1.0"
DISTRO_CODENAME = "2020-03"

DISTRO_FEATURES_remove = "bluetooth bluez5 gobject-introspection-data pulseaudio x11"
DISTRO_FEATURES_BACKFILL_CONSIDERED += "bluetooth bluez5 gobject-introspection-data pulseaudio"

# add support of wayland
DISTRO_FEATURES_append = " wayland"

# add opengl
DISTRO_FEATURES_append = " opengl vulkan"
```

## conf/distro/karo-x11.conf
```bitbake
require conf/distro/include/karo-distro.inc

DISTRO = "karo-x11"
DISTRO_NAME = "karo-x11 (Ka-Ro Linux BSP with X11 support)"
DISTRO_VERISON = "1.0"
DISTRO_CODENAME = "2020-03"

DISTRO_FEATURES_remove = "bluetooth bluez5 gobject-introspection-data pulseaudio wayland"
DISTRO_FEATURES_BACKFILL_CONSIDERED += "bluetooth bluez5 gobject-introspection-data pulseaudio"

# add support of X11
DISTRO_FEATURES_append = " x11"

# add opengl support
DISTRO_FEATURES_append = " opengl"
```

## conf/layer.conf
```bitbake
# We have a conf and classes directory, add to BBPATH
BBPATH .= ":${LAYERDIR}"

# We have a packages directory, add to BBFILES
BBFILES += "${LAYERDIR}/recipes-*/*/*.bb \
            ${LAYERDIR}/recipes-*/*/*.bbappend"

BBFILE_COLLECTIONS += "karo"
BBFILE_PATTERN_karo := "^${LAYERDIR}/"
BBFILE_PRIORITY_karo = "4"

LAYERDEPENDS_karo = "core networking-layer meta-python"
LAYERSERIES_COMPAT_karo = "mickledore"

BBMASK:append:stm32mp1 = " .*/*/linux-karo_5.10.bb"
BBMASK:append:stm32mp13 = " .*/*/linux-karo_5.15.bb"
BBMASK:append:rzg2l = " .*/*/linux-karo_5.15.bb"
BBMASK:append:rzg2l = " .*/*/linux-karo_6.1.bb"
```

## conf/machine/imx6dl-tx6-emmc.conf
```bitbake
#@TYPE: Machine
#@NAME: Ka-Ro electronics i.MX6DL TX6DL Computer-On-Module
#@SOC: i.MX6DL
#@DESCRIPTION: Machine configuration for Ka-Ro electronics TX6DL Computer-On-Module
#@MAINTAINER: Oliver Wendt <ow@karo-electronics.com>

require include/tx-base.inc
require conf/machine/include/tune-cortexa9.inc

TXTYPE = "imx6dl-tx6"
TXNVM = "emmc"

MACHINEOVERRIDES =. "mx6:mx6dl:tx6:${TXTYPE}-${TXNVM}:"
```

## conf/machine/imx6q-tx6-nand.conf
```bitbake
#@TYPE: Machine
#@NAME: Ka-Ro electronics i.MX6Q TX6Q Computer-On-Module
#@SOC: i.MX6Q
#@DESCRIPTION: Machine configuration for Ka-Ro electronics TX6Q Computer-On-Module
#@MAINTAINER: Lothar Waßmann <LW@KARO-electronics.de>

require include/tx-base.inc
require conf/machine/include/tune-cortexa9.inc

TXTYPE = "imx6q-tx6"
TXNVM = "nand"

MACHINEOVERRIDES =. "mx6:mx6q:tx6:${TXTYPE}-${TXNVM}:"
```

## conf/machine/imx6ul-txul-emmc.conf
```bitbake
#@TYPE: Machine
#@NAME: Ka-Ro electronics TX6UL eMMC
#@SOC: i.MX6UL
#@DESCRIPTION: Machine configuration for Ka-Ro electronics TX6UL (i.MX6UL) Computer-On-Module with eMMC
#@MAINTAINER: Oliver Wendt <ow@karo-electronics.com>

require include/tx-base.inc
require conf/machine/include/tune-cortexa7.inc

TXTYPE = "imx6ul-tx6"
TXNVM = "emmc"

MACHINEOVERRIDES =. "mx6ul:txul:${TXTYPE}-${TXNVM}:"
```

## conf/machine/imx6ull-txul-emmc.conf
```bitbake
#@TYPE: Machine
#@NAME: Ka-Ro electronics TX6ULL eMMC
#@SOC: i.MX6ULL
#@DESCRIPTION: Machine configuration for Ka-Ro electronics TX6ULL (i.MX6ULL) Computer-On-Module with eMMC
#@MAINTAINER: Oliver Wendt <ow@karo-electronics.com>

require include/tx-base.inc
require conf/machine/include/tune-cortexa7.inc

TXTYPE = "imx6ull-txul"
TXNVM = "emmc"

MACHINEOVERRIDES =. "mx6ul:txul:${TXTYPE}-${TXNVM}:"
```

## conf/machine/include/imx6dl-tx6-emmc.inc
```bitbake
require tx6-base.inc
require conf/machine/include/arm/armv7a/tune-cortexa9.inc

MACHINEOVERRIDES =. "mx6dl:tx6:tx6-emmc:"

MACHINE_FEATURES += "emmc"
```

## conf/machine/include/imx6dl-tx6-nand.inc
```bitbake
require tx6-base.inc
require conf/machine/include/arm/armv7a/tune-cortexa9.inc

MACHINEOVERRIDES =. "mx6dl:tx6:tx6-nand:"

MACHINE_FEATURES += "nand"
```

## conf/machine/include/imx6q-tx6-emmc.inc
```bitbake
require tx6-base.inc
require conf/machine/include/tune-cortexa9.inc

MACHINEOVERRIDES =. "mx6q:tx6:"

MACHINE_FEATURES += "emmc"
```

## conf/machine/include/imx6qp-tx6-emmc.inc
```bitbake
DTB_BASENAME:mx6q ?= "imx6qp-${MACHINE}"

require tx6-base.inc
require conf/machine/include/arm/armv7a/tune-cortexa9.inc

MACHINEOVERRIDES =. "mx6q:tx6:tx6-emmc:"

MACHINE_FEATURES += "emmc"
```

## conf/machine/include/imx6ul-txul-nand.inc
```bitbake
require tx6-base.inc
require conf/machine/include/tune-cortexa7.inc

MACHINEOVERRIDES =. "mx6ul:txul:tx6-nand:"

MACHINE_FEATURES += "nand"
```

## conf/machine/include/imx6ull-txul-emmc.inc
```bitbake
DTB_BASENAME:mx6ul ?= "imx6ull-${MACHINE}"

require tx6-base.inc
require conf/machine/include/arm/armv7a/tune-cortexa7.inc

MACHINEOVERRIDES =. "mx6ul:txul:tx6-emmc:"

MACHINE_FEATURES += "emmc"
```

## conf/machine/include/rzg2-base.inc
```bitbake
MACHINEOVERRIDES =. "r9a07g044l:rzg2:rzg2l:"

include conf/machine/include/karo.inc
require conf/machine/include/arm/armv8-2a/tune-cortexa55.inc

DEFAULTTUNE = "cortexa55"

SOC_PREFIX = "r9a07g044l2"
SOC_FAMILY ??= "${SOC_PREFIX}"

PREFERRED_VERSION_linux-karo = "5.10"

# build u-boot with image
EXTRA_IMAGEDEPENDS += "flashwriter-rzg2"

KERNEL_IMAGETYPE ?= "Image"

MACHINE_FEATURES:append = " emmc"
MACHINE_FEATURES:append:qsrz = " dsi83"

UBOOT_CONFIG ??= "generic noenv"

# Set Serial consoles
SERIAL_CONSOLES ?= "115200;ttySC0 115200;ttySC1 ${@ bb.utils.contains('DISTRO_FEATURES', 'copro', "", "115200;ttySC2", d)}"
SERIAL_CONSOLES:txrz ?= "115200;ttySC0 115200;ttySC1"

DTB_BASENAME ?= "r9a07g044l2-${MACHINE}"
```

## conf/machine/include/rzg2-overlays.inc
```bitbake
require karo-dtb-overlays.inc

# DTB overlays depending on module
DTB_OVERLAYS ??= ""

DTB_OVERLAYS:append:rzg2 = " \
    karo-copro \
    karo-otg-host \
    karo-led \
    karo-sdcard \
    karo-sdcard-cd \
"

DTB_OVERLAY_INCLUDES ??= " \
    karo-lcd-panel \
"

DTB_OVERLAYS:append:txrz = " \
    txrz-rtc \
    ${@ mach_overlay(d, "txrz-lvds-panel:txrz-lcd-panel", "txrz-g2l2")} \
    txrz-ft5x06 \
    txrz-sound \
"

DTB_OVERLAYS:append:qsrz = " \
    qsrz-ksz9131 \
    qsrz-lcd-panel \
    qsrz-ft5x06 \
    qsrz-ili2130 \
    qsrz-dsi83 \
    qsrz-raspi-display \
"

KARO_BASEBOARDS:txrz ?= "\
    mb7 \
"

KARO_BASEBOARDS:txrz-g2l2 ?= "\
    lvds-mb \
"

KARO_BASEBOARDS:qsrz ?= "\
    qsbase1 \
    qsbase4 \
    qsglyn1 \
"

# baseboard DTB specific overlays
KARO_DTB_OVERLAYS[mb7] = " \
    ${@ mach_overlay(d, "karo-copro", dist="copro")} \
    karo-led \
    karo-sdcard-cd \
    txrz-rtc \
    txrz-lcd-panel \
    txrz-ft5x06 \
    txrz-sound \
"

KARO_DTB_OVERLAYS[lvds-mb] = " \
    ${@ mach_overlay(d, "karo-copro", dist="copro")} \
    karo-led \
    karo-sdcard \
    txrz-rtc \
    txrz-lvds-panel \
    txrz-sound \
"

KARO_DTB_OVERLAYS[qsbase1] = " \
    ${@ mach_overlay(d, "karo-copro", dist="copro")} \
    karo-led \
    karo-sdcard \
    qsrz-lcd-panel \
    qsrz-ft5x06 \
    qsrz-ksz9131 \
"

KARO_DTB_OVERLAYS[qsbase4] = " \
    ${@ mach_overlay(d, "karo-copro", dist="copro")} \
    karo-led \
    karo-sdcard \
    qsrz-dsi83 \
    qsrz-raspi-display \
    qsrz-ksz9131 \
"

KARO_DTB_OVERLAYS[qsglyn1] = " \
    ${@ mach_overlay(d, "karo-copro", dist="copro")} \
    karo-led \
    karo-sdcard \
    qsrz-lcd-panel \
    qsrz-ili2130 \
    qsrz-dsi83 \
    qsrz-raspi-display \
    qsrz-ksz9131 \
"
```

## conf/machine/include/st-machine-common-stm32mp.inc
```bitbake
#@DESCRIPTION: Common Machine configuration for STM32 systems

require conf/machine/include/st-machine-flashlayout-stm32mp.inc

# =========================================================================
# boot scheme
# =========================================================================
# List of supported boot schemes
BOOTSCHEME_LABELS ??= "basic trusted"

# Don't include kernels in standard images
#RDEPENDS_${KERNEL_PACKAGE_NAME}-base = ""

MACHINE_FEATURES_append = " emmc"
#IMAGE_FSTYPES ?= "tar.bz2"
IMAGE_FSTYPES_append = "${@bb.utils.contains('MACHINE_FEATURES',"emmc"," ext4","",d)}"

# =========================================================================
# Image
# =========================================================================
# Partitions configuration
IMAGE_CLASSES += "st-partitions-image"

# Define image to use for extra partitions
STM32MP_BOOTFS_IMAGE = "karo-image-bootfs"
STM32MP_BOOTFS_LABEL = "bootfs"
STM32MP_BOOTFS_MOUNTPOINT_IMAGE = "/boot"
STM32MP_USERFS_IMAGE = "karo-image-userfs"
STM32MP_USERFS_LABEL = "userfs"
STM32MP_USERFS_MOUNTPOINT_IMAGE = "/usr/local"

# Define extra partition to build
PARTITIONS_IMAGE  = "${STM32MP_BOOTFS_IMAGE}"
PARTITIONS_IMAGE += "${STM32MP_USERFS_IMAGE}"
PARTITIONS_MOUNTPOINT_IMAGE  = "${STM32MP_BOOTFS_MOUNTPOINT_IMAGE}"
PARTITIONS_MOUNTPOINT_IMAGE += "${STM32MP_USERFS_MOUNTPOINT_IMAGE}"

# Provide list of partition to mount
MOUNT_PARTITIONS_LIST  = "${STM32MP_BOOTFS_LABEL},${STM32MP_BOOTFS_MOUNTPOINT_IMAGE}"
MOUNT_PARTITIONS_LIST += "${STM32MP_USERFS_LABEL},${STM32MP_USERFS_MOUNTPOINT_IMAGE}"

# Define image partition size (supposed to be set as max size in image recipe)
# Proposed value for bootfs is 64MB
BOOTFS_PARTITION_SIZE = "65536"
# Proposed value for rootfs should fit our highest constraint: NAND size (128MiB)
# For optee bootscheme we have the maximum partitions:
#   FSBL1 + SSBL + SSBL2 + TEEH + TEED + TEEX + Multivolume UBI = NAND size
#   Multivolume UBI = 128MiB - (2MiB + 2MiB + 2MiB + 512KiB + 512KiB + 512KiB) = 1016.5MiB
# With multivolume UBI split:
#   Multivolume UBI > uboot_config + uboot_config_r + bootfs + rootfs + userfs + UBI Overhead
# From http://www.linux-mtd.infradead.org/doc/ubi.html#L_overhead, we compute
# the UBI overhead for our NAND:
#   (20*4096/1024 + 4) * 256KiB + (256KiB - 248KiB) * (1016.5MiB/256KiB - 20*4096/1024 - 4) = 53360KiB
# In addition, for each UBIFS, our NAND consummed 9 extra eraseblocks
# So:
#   rootfs < Multivolume UBI - (rootfs + env + dtb + kernel + userfs + UBI Overhead + 4 * 9*eraseblocks)
#   rootfs < 120.5MiB - (256KiB + 64MiB + 16MiB + 128MiB + 53360KiB + 4 * 9 * 256KiB)
# Proposed value for rootfs is 2GiB
ROOTFS_PARTITION_SIZE ??= "2097152"
ROOTFS_PARTITION_SIZE_qsmp-1510 ??= "32*1024"
# Proposed value for userfs is 128MB (4*32MB)
USERFS_PARTITION_SIZE ??= "131072"

# Define the max size for ROOTFS image being built
# On other image partition such settings is directly done in image recipe
IMAGE_ROOTFS_MAXSIZE ?= ""

# Define specific U-Boot config partition settings
STM32MP_UBOOTCONFIG_NAME   = "uboot_config"
UBOOTCONFIG_PARTITION_SIZE ??= "256"

# Define specific EXT4 command line:
#   - Create minimal inode number (as it is done by default in image_types.bbclass)
#   - Add label name (maximum length of the volume label is 16 bytes)
#     So use IMAGE_NAME_SUFFIX name by removing the '.' and truncating to 16 caracters
#   - Deactivate metadata_csum and dir_index (hashed b-trees): update not supported
#     by U-Boot
EXTRA_IMAGECMD_ext4 = "-i 4096 -L ${@d.getVar('IMAGE_NAME_SUFFIX').replace('.', '', 1)[:16]} -O ^metadata_csum,^dir_index"

# =========================================================================
# tf-a
# =========================================================================
# Finally we must compile tf-a in all cases as we need trusted binary to boot
EXTRA_IMAGEDEPENDS += "tf-a-stm32mp"

# Define default TF-A config
TF_A_CONFIG_append = "${@bb.utils.contains('BOOTSCHEME_LABELS', 'trusted', ' trusted', '', d)}"

# Define SECURE_PAYLOAD config to set for each TF_A_CONFIG
TF_A_CONFIG_serialboot  = "AARCH32_SP=sp_min"
TF_A_CONFIG_trusted     = "AARCH32_SP=sp_min"

# Manage proper update for TF_A_CONFIG_* var
tfaconfig_env[vardeps] += "${@bb.utils.contains('TF_A_CONFIG', 'serialboot', 'TF_A_CONFIG_serialboot', '', d)}"
tfaconfig_env[vardeps] += "${@bb.utils.contains('TF_A_CONFIG', 'trusted', 'TF_A_CONFIG_trusted', '', d)}"

# List of TF-A device tree to use
TF_A_DEVICETREE = "${STM32MP_DEVICETREE}"

# =========================================================================
# flashlayout
# =========================================================================
# Define bootscheme label to allow specific expansion for partition vars
FLASHLAYOUT_BOOTSCHEME_LABELS += "${BOOTSCHEME_LABELS}"

# Default config labels supported
FLASHLAYOUT_CONFIG_LABELS ??= ""
```

## conf/machine/include/stm32mp13-overlays.inc
```bitbake
require karo-dtb-overlays.inc

# DTB overlays
DTB_OVERLAYS ??= ""

DTB_OVERLAY_INCLUDES ?= "\
"

DTB_OVERLAYS_generic:append:qsmp = " \
        qsmp-ft5x06 \
        qsmp-lcd-panel \
        qsmp-ksz9031 \
        qsmp-ksz9131 \
        qsmp-qsbase1 \
        qsmp-qsbase4 \
"

KARO_BASEBOARDS:qsmp ?= "\
        qsbase1 \
        qsbase4 \
"

KARO_DTB_OVERLAYS[qsbase1] = " \
        qsmp-qsbase1 \
        qsmp-ksz9031 \
        qsmp-lcd-panel \
        qsmp-ft5x06 \
"

KARO_DTB_OVERLAYS[qsbase4] = " \
        qsmp-qsbase4 \
        qsmp-ksz9131 \
"
```
